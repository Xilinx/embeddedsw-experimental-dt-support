	&psv_cortexa72_0 {
		stamp-frequency = <99999901>;
		xlnx,timestamp-clk-freq = <99999901>;
		xlnx,rable = <0>;
		xlnx,pss-ref-clk-freq = <33333300>;
		xlnx,ip-name = "psv_cortexa72";
		bus-handle = <&amba>;
		cpu-frequency = <1399998657>;
		xlnx,cpu-clk-freq-hz = <1399998657>;
	};
	&psv_cortexa72_1 {
		stamp-frequency = <99999901>;
		xlnx,ip-name = "psv_cortexa72";
		bus-handle = <&amba>;
		cpu-frequency = <1399998657>;
	};
	&lpd_dma_chan0 {
		xlnx,rable = <0>;
		xlnx,is-cache-coherent = <0>;
		status = "okay";
		bus-master-id = <&lpd_xppu 0x210>;
		xlnx,ip-name = "psv_adma";
		xlnx,dma-mode = <1>;
		firewall-0 = <&lpd_xppu>;
		xlnx,name = "versal_cips_0_pspmc_0_psv_adma_0";
	};
	&lpd_dma_chan1 {
		xlnx,rable = <0>;
		xlnx,is-cache-coherent = <0>;
		status = "okay";
		bus-master-id = <&lpd_xppu 0x212>;
		xlnx,ip-name = "psv_adma";
		xlnx,dma-mode = <1>;
		firewall-0 = <&lpd_xppu>;
		xlnx,name = "versal_cips_0_pspmc_0_psv_adma_1";
	};
	&lpd_dma_chan2 {
		xlnx,rable = <0>;
		xlnx,is-cache-coherent = <0>;
		status = "okay";
		bus-master-id = <&lpd_xppu 0x214>;
		xlnx,ip-name = "psv_adma";
		xlnx,dma-mode = <1>;
		firewall-0 = <&lpd_xppu>;
		xlnx,name = "versal_cips_0_pspmc_0_psv_adma_2";
	};
	&lpd_dma_chan3 {
		xlnx,rable = <0>;
		xlnx,is-cache-coherent = <0>;
		status = "okay";
		bus-master-id = <&lpd_xppu 0x216>;
		xlnx,ip-name = "psv_adma";
		xlnx,dma-mode = <1>;
		firewall-0 = <&lpd_xppu>;
		xlnx,name = "versal_cips_0_pspmc_0_psv_adma_3";
	};
	&lpd_dma_chan4 {
		xlnx,rable = <0>;
		xlnx,is-cache-coherent = <0>;
		status = "okay";
		bus-master-id = <&lpd_xppu 0x218>;
		xlnx,ip-name = "psv_adma";
		xlnx,dma-mode = <1>;
		firewall-0 = <&lpd_xppu>;
		xlnx,name = "versal_cips_0_pspmc_0_psv_adma_4";
	};
	&lpd_dma_chan5 {
		xlnx,rable = <0>;
		xlnx,is-cache-coherent = <0>;
		status = "okay";
		bus-master-id = <&lpd_xppu 0x21a>;
		xlnx,ip-name = "psv_adma";
		xlnx,dma-mode = <1>;
		firewall-0 = <&lpd_xppu>;
		xlnx,name = "versal_cips_0_pspmc_0_psv_adma_5";
	};
	&lpd_dma_chan6 {
		xlnx,rable = <0>;
		xlnx,is-cache-coherent = <0>;
		status = "okay";
		bus-master-id = <&lpd_xppu 0x21c>;
		xlnx,ip-name = "psv_adma";
		xlnx,dma-mode = <1>;
		firewall-0 = <&lpd_xppu>;
		xlnx,name = "versal_cips_0_pspmc_0_psv_adma_6";
	};
	&lpd_dma_chan7 {
		xlnx,rable = <0>;
		xlnx,is-cache-coherent = <0>;
		status = "okay";
		bus-master-id = <&lpd_xppu 0x21e>;
		xlnx,ip-name = "psv_adma";
		xlnx,dma-mode = <1>;
		firewall-0 = <&lpd_xppu>;
		xlnx,name = "versal_cips_0_pspmc_0_psv_adma_7";
	};
	&can1 {
		firewall-0 = <&lpd_xppu>;
		xlnx,rable = <0>;
		xlnx,ip-name = "psv_canfd";
		xlnx,num-of-rx-mb-buf = <48>;
		xlnx,can-clk-freq-hz = <99999901>;
		xlnx,rx-mode = <0>;
		xlnx,can-board-interface = "custom";
		xlnx,num-of-tx-buf = <32>;
		status = "okay";
		xlnx,can-rx-dpth = <64>;
		xlnx,can-tx-dpth = <32>;
		xlnx,name = "versal_cips_0_pspmc_0_psv_canfd_1";
	};
	&coresight {
		xlnx,rable = <0>;
		status = "okay";
		xlnx,ip-name = "psv_coresight";
		firewall-0 = <&pmc_xppu>;
		xlnx,name = "versal_cips_0_pspmc_0_psv_coresight_0";
	};
	&gem0 {
		xlnx,has-mdio = <1>;
		xlnx,is-cache-coherent = <0>;
		xlnx,gem-board-interface = "custom";
		phy-mode = "rgmii-id";
		firewall-0 = <&lpd_xppu>;
		xlnx,enet-slcr-1000mbps-div0 = <4>;
		xlnx,enet-slcr-10mbps-div0 = <200>;
		xlnx,rable = <0>;
		xlnx,enet-tsu-clk-freq-hz = <249999756>;
		xlnx,ip-name = "psv_ethernet";
		xlnx,eth-mode = <1>;
		xlnx,enet-clk-freq-hz = <124999878>;
		xlnx,enet-slcr-100mbps-div0 = <20>;
		local-mac-address = [ 00 0a 23 00 00 00 ];
		status = "okay";
		bus-master-id = <&lpd_xppu 0x234>;
		xlnx,name = "versal_cips_0_pspmc_0_psv_ethernet_0";
	};
	&gem1 {
		xlnx,has-mdio = <0>;
		xlnx,is-cache-coherent = <0>;
		xlnx,gem-board-interface = "custom";
		phy-mode = "rgmii-id";
		firewall-0 = <&lpd_xppu>;
		xlnx,enet-slcr-1000mbps-div0 = <4>;
		xlnx,enet-slcr-10mbps-div0 = <200>;
		xlnx,rable = <0>;
		xlnx,enet-tsu-clk-freq-hz = <249999756>;
		xlnx,ip-name = "psv_ethernet";
		xlnx,eth-mode = <1>;
		xlnx,enet-clk-freq-hz = <124999878>;
		xlnx,enet-slcr-100mbps-div0 = <20>;
		local-mac-address = [ 00 0a 23 00 00 01 ];
		status = "okay";
		bus-master-id = <&lpd_xppu 0x235>;
		xlnx,name = "versal_cips_0_pspmc_0_psv_ethernet_1";
	};
	&fpd_xmpu {
		xlnx,rable = <0>;
		compatible = "xlnx,xmpu" , "xlnx,ctrlregs";
		status = "okay";
		xlnx,ip-name = "psv_fpd_slave_xmpu";
		firewall-0 = <&fpd_xmpu>;
		xlnx,name = "versal_cips_0_pspmc_0_psv_fpd_slave_xmpu_0";
	};
	&smmu {
		xlnx,rable = <0>;
		status = "okay";
		xlnx,ip-name = "psv_fpd_smmutcu";
		firewall-0 = <&fpd_xmpu>;
		xlnx,name = "versal_cips_0_pspmc_0_psv_fpd_smmutcu_0";
	};
	&i2c0 {
		xlnx,rable = <0>;
		status = "okay";
		xlnx,clock-freq = <99999901>;
		xlnx,i2c-clk-freq-hz = <99999901>;
		xlnx,ip-name = "psv_i2c";
		xlnx,iic-board-interface = "custom";
		firewall-0 = <&lpd_xppu>;
		xlnx,name = "versal_cips_0_pspmc_0_psv_i2c_0";
	};
	&i2c1 {
		xlnx,rable = <0>;
		status = "okay";
		xlnx,clock-freq = <99999901>;
		xlnx,i2c-clk-freq-hz = <99999901>;
		xlnx,ip-name = "psv_i2c";
		xlnx,iic-board-interface = "custom";
		firewall-0 = <&lpd_xppu>;
		xlnx,name = "versal_cips_0_pspmc_0_psv_i2c_1";
	};
	&ipi3 {
		xlnx,rable = <0>;
		xlnx,cpu-name = "A72";
		xlnx,buffer-base = <0xFF3F0400>;
		status = "okay";
		xlnx,buffer-index = <0x2>;
		xlnx,ip-name = "psv_ipi";
		firewall-0 = <&lpd_xppu>;
		xlnx,int-id = <62>;
		xlnx,bit-position = <2>;
		xlnx,name = "versal_cips_0_pspmc_0_psv_ipi_0";
	};
	&ipi4 {
		xlnx,rable = <0>;
		xlnx,cpu-name = "A72";
		xlnx,buffer-base = <0xFF3F0600>;
		status = "okay";
		xlnx,buffer-index = <0x3>;
		xlnx,ip-name = "psv_ipi";
		firewall-0 = <&lpd_xppu>;
		xlnx,int-id = <63>;
		xlnx,bit-position = <3>;
		xlnx,name = "versal_cips_0_pspmc_0_psv_ipi_1";
	};
	&ipi5 {
		xlnx,rable = <0>;
		xlnx,cpu-name = "A72";
		xlnx,buffer-base = <0xFF3F0800>;
		status = "okay";
		xlnx,buffer-index = <0x4>;
		xlnx,ip-name = "psv_ipi";
		firewall-0 = <&lpd_xppu>;
		xlnx,int-id = <64>;
		xlnx,bit-position = <4>;
		xlnx,name = "versal_cips_0_pspmc_0_psv_ipi_2";
	};
	&ipi6 {
		xlnx,rable = <0>;
		xlnx,cpu-name = "A72";
		xlnx,buffer-base = <0xFF3F0A00>;
		status = "okay";
		xlnx,buffer-index = <0x5>;
		xlnx,ip-name = "psv_ipi";
		firewall-0 = <&lpd_xppu>;
		xlnx,int-id = <65>;
		xlnx,bit-position = <5>;
		xlnx,name = "versal_cips_0_pspmc_0_psv_ipi_3";
	};
	&ipi7 {
		xlnx,rable = <0>;
		xlnx,cpu-name = "A72";
		xlnx,buffer-base = <0xFF3F0C00>;
		status = "okay";
		xlnx,buffer-index = <0x6>;
		xlnx,ip-name = "psv_ipi";
		firewall-0 = <&lpd_xppu>;
		xlnx,int-id = <66>;
		xlnx,bit-position = <6>;
		xlnx,name = "versal_cips_0_pspmc_0_psv_ipi_4";
	};
	&ipi8 {
		xlnx,rable = <0>;
		xlnx,cpu-name = "A72";
		xlnx,buffer-base = <0xFF3F0E00>;
		status = "okay";
		xlnx,buffer-index = <0x7>;
		xlnx,ip-name = "psv_ipi";
		firewall-0 = <&lpd_xppu>;
		xlnx,int-id = <67>;
		xlnx,bit-position = <7>;
		xlnx,name = "versal_cips_0_pspmc_0_psv_ipi_5";
	};
	&ipi9 {
		xlnx,rable = <0>;
		xlnx,cpu-name = "A72";
		xlnx,buffer-base = "NIL";
		status = "okay";
		xlnx,buffer-index = "NIL";
		xlnx,ip-name = "psv_ipi";
		firewall-0 = <&lpd_xppu>;
		xlnx,int-id = <68>;
		xlnx,bit-position = <9>;
		xlnx,name = "versal_cips_0_pspmc_0_psv_ipi_6";
	};
	&ipi0 {
		xlnx,rable = <0>;
		xlnx,cpu-name = "PMC";
		xlnx,buffer-base = <0xFF3F0200>;
		status = "okay";
		xlnx,buffer-index = <0x1>;
		xlnx,ip-name = "psv_ipi";
		firewall-0 = <&lpd_xppu>;
		xlnx,int-id = <59>;
		xlnx,bit-position = <1>;
		xlnx,name = "versal_cips_0_pspmc_0_psv_ipi_pmc";
	};
	&ipi1 {
		xlnx,rable = <0>;
		xlnx,cpu-name = "PMC";
		xlnx,buffer-base = "NIL";
		status = "okay";
		xlnx,buffer-index = "NIL";
		xlnx,ip-name = "psv_ipi";
		firewall-0 = <&lpd_xppu>;
		xlnx,int-id = <60>;
		xlnx,bit-position = <8>;
		xlnx,name = "versal_cips_0_pspmc_0_psv_ipi_pmc_nobuf";
	};
	&ipi2 {
		xlnx,rable = <0>;
		xlnx,cpu-name = "PSM";
		xlnx,buffer-base = <0xFF3F0000>;
		status = "okay";
		xlnx,buffer-index = <0x0>;
		xlnx,ip-name = "psv_ipi";
		firewall-0 = <&lpd_xppu>;
		xlnx,int-id = <61>;
		xlnx,bit-position = <0>;
		xlnx,name = "versal_cips_0_pspmc_0_psv_ipi_psm";
	};
	&lpd_xppu {
		xlnx,rable = <0>;
		compatible = "xlnx,xppu" , "xlnx,ctrlregs";
		status = "okay";
		xlnx,ip-name = "psv_lpd_xppu";
		firewall-0 = <&lpd_xppu>;
		xlnx,name = "versal_cips_0_pspmc_0_psv_lpd_xppu_0";
	};
	&ocm_xmpu {
		xlnx,rable = <0>;
		compatible = "xlnx,xmpu" , "xlnx,ctrlregs";
		status = "okay";
		xlnx,ip-name = "psv_ocm_xmpu";
		firewall-0 = <&lpd_xppu>;
		xlnx,name = "versal_cips_0_pspmc_0_psv_ocm_xmpu_0";
	};
	&dma0 {
		xlnx,rable = <0>;
		compatible = "xlnx,zynqmp-csudma-1.0" , "xlnx,ctrlregs";
		status = "okay";
		xlnx,ip-name = "psv_pmc_dma";
		firewall-0 = <&pmc_xppu>;
		xlnx,name = "versal_cips_0_pspmc_0_psv_pmc_dma_0";
	};
	&dma1 {
		xlnx,rable = <0>;
		compatible = "xlnx,zynqmp-csudma-1.0" , "xlnx,ctrlregs";
		status = "okay";
		xlnx,ip-name = "psv_pmc_dma";
		firewall-0 = <&pmc_xppu>;
		xlnx,name = "versal_cips_0_pspmc_0_psv_pmc_dma_1";
	};
	&gpio1 {
		xlnx,rable = <0>;
		compatible = "xlnx,pmc-gpio-1.0" , "xlnx,ctrlregs";
		status = "okay";
		xlnx,ip-name = "psv_pmc_gpio";
		firewall-0 = <&pmc_xppu>;
		xlnx,name = "versal_cips_0_pspmc_0_psv_pmc_gpio_0";
	};
	&iomodule0 {
		xlnx,gpo4-size = <32>;
		xlnx,tmr = <0>;
		xlnx,pit1-readable = <1>;
		xlnx,mask = <0x00000000 0xFFFFF000>;
		xlnx,pit-size = < 32 32 32 32 >;
		xlnx,pit2-prescaler = <0>;
		xlnx,gpi3-interrupt = <0>;
		xlnx,intc-level-edge = <0x7fff>;
		xlnx,rable = <0>;
		xlnx,intc-positive = <0xFFFF>;
		xlnx,ip-name = "iomodule";
		xlnx,gpo1-size = <3>;
		xlnx,max-intr-size = <32>;
		xlnx,pit3-size = <32>;
		xlnx,fit3-interrupt = <0>;
		xlnx,fit1-no-clocks = <6216>;
		xlnx,gpi2-size = <32>;
		xlnx,pit2-readable = <1>;
		xlnx,intc-irq-connection = <0>;
		xlnx,uart-tx-interrupt = <1>;
		xlnx,use-config-reset = <0>;
		xlnx,io-highaddr = <0x00000000 0x00000000>;
		xlnx,pit2-interrupt = <1>;
		xlnx,intc-base-vectors = <0xF0240000>;
		xlnx,family = "elbert";
		compatible = "xlnx,iomodule-3.1" , "xlnx,ctrlregs";
		xlnx,gpo4-init = <0x00000000>;
		xlnx,pit3-readable = <1>;
		xlnx,pit3-prescaler = <9>;
		xlnx,gpi4-interrupt = <0>;
		xlnx,gpo1-init = <0x00000000>;
		xlnx,use-io-bus = <0>;
		xlnx,use-gpo1 = <1>;
		xlnx,uart-baudrate = <115200>;
		xlnx,fit4-interrupt = <0>;
		xlnx,gpo3-size = <32>;
		xlnx,use-gpo2 = <0>;
		xlnx,uart-data-bits = <8>;
		xlnx,pit-prescaler = < 9 0 9 0 >;
		xlnx,use-gpo3 = <0>;
		xlnx,fit2-no-clocks = <6216>;
		xlnx,gpio1-board-interface = "Custom";
		xlnx,options = <1>;
		xlnx,use-gpo4 = <0>;
		xlnx,gpi4-size = <32>;
		xlnx,gpio2-board-interface = "Custom";
		xlnx,uart-rx-interrupt = <1>;
		xlnx,uart-error-interrupt = <1>;
		xlnx,gpio3-board-interface = "Custom";
		xlnx,pit4-readable = <1>;
		xlnx,intc-use-irq-out = <0>;
		xlnx,baseaddr = <0xF0280000>;
		status = "okay";
		xlnx,gpio4-board-interface = "Custom";
		xlnx,clock-freq = <100000000>;
		xlnx,gpo-init = < 0 0 0 0 >;
		xlnx,use-board-flow;
		xlnx,pit2-size = <32>;
		xlnx,intc-use-ext-intr = <1>;
		xlnx,intc-intr-size = <16>;
		xlnx,name = "versal_cips_0_pspmc_0_psv_pmc_iomodule_0";
		xlnx,gpi1-size = <32>;
		xlnx,pit3-interrupt = <1>;
		xlnx,edk-special = "INTR_CTRL";
		xlnx,intc-has-fast = <0>;
		xlnx,pit-used = < 1 1 1 1 >;
		xlnx,use-gpi1 = <0>;
		xlnx,gpi1-interrupt = <0>;
		xlnx,use-gpi2 = <0>;
		xlnx,use-gpi3 = <0>;
		xlnx,use-gpi4 = <0>;
		xlnx,fit1-interrupt = <0>;
		xlnx,pit4-prescaler = <0>;
		xlnx,gpo3-init = <0x00000000>;
		xlnx,intc-addr-width = <32>;
		xlnx,edk-iptype = "PERIPHERAL";
		xlnx,fit3-no-clocks = <6216>;
		xlnx,use-uart-rx = <1>;
		xlnx,instance = "iomodule_0";
		xlnx,pit-mask = <0xFFFFFFFF 0xFFFFFFFF 0xFFFFFFFF 0xFFFFFFFF>;
		xlnx,uart-prog-baudrate = <1>;
		xlnx,use-pit1 = <1>;
		xlnx,gpo2-size = <32>;
		xlnx,use-pit2 = <1>;
		xlnx,pit4-size = <32>;
		xlnx,pit-readable = < 1 1 1 1 >;
		xlnx,use-pit3 = <1>;
		xlnx,use-pit4 = <1>;
		xlnx,pit4-interrupt = <1>;
		xlnx,gpi3-size = <32>;
		xlnx,highaddr = <0xF0280FFF>;
		xlnx,intc-async-intr = <0xFFFF>;
		xlnx,pit1-prescaler = <9>;
		xlnx,avoid-primitives = <0>;
		xlnx,gpi2-interrupt = <0>;
		xlnx,use-tmr-disable = <0>;
		xlnx,use-fit1 = <0>;
		xlnx,pit1-size = <32>;
		xlnx,intc-num-sync-ff = <2>;
		xlnx,use-fit2 = <0>;
		xlnx,uart-board-interface = "rs232_uart";
		xlnx,fit2-interrupt = <0>;
		xlnx,use-fit3 = <0>;
		xlnx,use-fit4 = <0>;
		xlnx,io-baseaddr = <0xffffffff 0xFFFFFFFF>;
		xlnx,uart-use-parity = <0>;
		xlnx,lmb-dwidth = <32>;
		xlnx,fit4-no-clocks = <6216>;
		xlnx,uart-odd-parity = <0>;
		xlnx,freq = <100000000>;
		xlnx,use-uart-tx = <1>;
		xlnx,pit1-interrupt = <1>;
		xlnx,lmb-awidth = <32>;
		xlnx,io-mask = <0x00000000 0xFFFE0000>;
		xlnx,gpo2-init = <0x00000000>;
	};
	&qspi {
		xlnx,is-cache-coherent = <0>;
		firewall-0 = <&pmc_xppu>;
		xlnx,qspi-clk-freq-hz = <295833038>;
		xlnx,rable = <0>;
		xlnx,bus-width = <2>;
		xlnx,ip-name = "psv_pmc_qspi";
		spi-rx-bus-width = <4>;
		xlnx,connection-mode = <2>;
		spi-tx-bus-width = <4>;
		status = "okay";
		xlnx,clock-freq = <295833038>;
		xlnx,qspi-mode = <2>;
		bus-master-id = <&pmc_xppu 0x244>;
		xlnx,name = "versal_cips_0_pspmc_0_psv_pmc_qspi_0";
		xlnx,qspi-bus-width = <2>;
		is-dual = <1>;
	};
	&rtc {
		xlnx,rable = <0>;
		status = "okay";
		xlnx,ip-name = "psv_pmc_rtc";
		firewall-0 = <&pmc_xppu>;
		xlnx,name = "versal_cips_0_pspmc_0_psv_pmc_rtc_0";
	};
	&sdhci1 {
		xlnx,sd-board-interface = "custom";
		xlnx,is-cache-coherent = <0>;
		xlnx,clk-50-ddr-otap-dly = <0x3>;
		xlnx,clk-50-sdr-itap-dly = <0x2C>;
		xlnx,has-emio = <0>;
		clock-frequency = <0xbebc13a>;
		firewall-0 = <&pmc_xppu>;
		xlnx,clk-100-sdr-otap-dly = <0x3>;
		xlnx,rable = <0>;
		xlnx,mio-bank = <0x1>;
		xlnx,ip-name = "psv_pmc_sd";
		xlnx,bus-width = <8>;
		xlnx,card-detect = <1>;
		xlnx,has-wp = <0>;
		xlnx,has-cd = <1>;
		xlnx,slot-type = <3>;
		xlnx,clk-50-sdr-otap-dly = <0x4>;
		xlnx,clk-50-ddr-itap-dly = <0x36>;
		xlnx,has-power = <1>;
		status = "okay";
		xlnx,clk-200-sdr-otap-dly = <0x2>;
		bus-master-id = <&pmc_xppu 0x243>;
		xlnx,sdio-clk-freq-hz = <199999802>;
		xlnx,write-protect = <0>;
		xlnx,name = "versal_cips_0_pspmc_0_psv_pmc_sd_1";
	};
	&sysmon0 {
		xlnx,rable = <0>;
		compatible = "xlnx,versal-sysmon" , "xlnx,ctrlregs";
		status = "okay";
		#address-cells = <2>;
		xlnx,ip-name = "psv_pmc_sysmon";
		xlnx,numchannels = "/bits/8 , <0>";
		#size-cells = <2>;
		firewall-0 = <&pmc_xppu>;
		xlnx,name = "versal_cips_0_pspmc_0_psv_pmc_sysmon_0";
	};
	&pmc_xmpu {
		xlnx,rable = <0>;
		compatible = "xlnx,xmpu" , "xlnx,ctrlregs";
		status = "okay";
		xlnx,ip-name = "psv_pmc_xmpu";
		firewall-0 = <&pmc_xppu>;
		xlnx,name = "versal_cips_0_pspmc_0_psv_pmc_xmpu_0";
	};
	&pmc_xppu {
		xlnx,rable = <0>;
		compatible = "xlnx,xppu" , "xlnx,ctrlregs";
		status = "okay";
		xlnx,ip-name = "psv_pmc_xppu";
		firewall-0 = <&pmc_xppu>;
		xlnx,name = "versal_cips_0_pspmc_0_psv_pmc_xppu_0";
	};
	&pmc_xppu_npi {
		xlnx,rable = <0>;
		compatible = "xlnx,xppu" , "xlnx,ctrlregs";
		status = "okay";
		xlnx,ip-name = "psv_pmc_xppu_npi";
		firewall-0 = <&pmc_xppu>;
		xlnx,name = "versal_cips_0_pspmc_0_psv_pmc_xppu_npi_0";
	};
	&gic_a72 {
		xlnx,rable = <0>;
		status = "okay";
		xlnx,ip-name = "psv_acpu_gic";
		firewall-0 = <&fpd_xmpu>;
		xlnx,name = "versal_cips_0_pspmc_0_psv_acpu_gic";
	};
	&gic_r5 {
		xlnx,rable = <0>;
		status = "okay";
	};
	&serial0 {
		xlnx,has-modem = <0>;
		xlnx,uart-clk-freq-hz = <99999901>;
		firewall-0 = <&lpd_xppu>;
		port-number = <0>;
		xlnx,rable = <0>;
		xlnx,ip-name = "psv_sbsauart";
		xlnx,uart-board-interface = "custom";
		xlnx,baudrate = <115200>;
		cts-override;
		u-boot,dm-pre-reloc;
		status = "okay";
		xlnx,clock-freq = <99999901>;
		xlnx,name = "versal_cips_0_pspmc_0_psv_sbsauart_0";
	};
	&ttc0 {
		xlnx,ttc-clk2-clksrc = <0>;
		firewall-0 = <&lpd_xppu>;
		xlnx,rable = <0>;
		xlnx,ip-name = "psv_ttc";
		xlnx,ttc-clk1-clksrc = <0>;
		xlnx,ttc-clk0-freq-hz = <149999863>;
		xlnx,ttc-clk1-freq-hz = <149999863>;
		status = "okay";
		xlnx,ttc-board-interface = "custom";
		xlnx,ttc-clk2-freq-hz = <149999863>;
		xlnx,clock-freq = <149999863>;
		xlnx,name = "versal_cips_0_pspmc_0_psv_ttc_0";
		xlnx,ttc-clk0-clksrc = <0>;
	};
	&ttc1 {
		xlnx,ttc-clk2-clksrc = <0>;
		firewall-0 = <&lpd_xppu>;
		xlnx,rable = <0>;
		xlnx,ip-name = "psv_ttc";
		xlnx,ttc-clk1-clksrc = <0>;
		xlnx,ttc-clk0-freq-hz = <149999863>;
		xlnx,ttc-clk1-freq-hz = <149999863>;
		status = "okay";
		xlnx,ttc-board-interface = "custom";
		xlnx,ttc-clk2-freq-hz = <149999863>;
		xlnx,clock-freq = <149999863>;
		xlnx,name = "versal_cips_0_pspmc_0_psv_ttc_1";
		xlnx,ttc-clk0-clksrc = <0>;
	};
	&ttc2 {
		xlnx,ttc-clk2-clksrc = <0>;
		firewall-0 = <&lpd_xppu>;
		xlnx,rable = <0>;
		xlnx,ip-name = "psv_ttc";
		xlnx,ttc-clk1-clksrc = <0>;
		xlnx,ttc-clk0-freq-hz = <149999863>;
		xlnx,ttc-clk1-freq-hz = <149999863>;
		status = "okay";
		xlnx,ttc-board-interface = "custom";
		xlnx,ttc-clk2-freq-hz = <149999863>;
		xlnx,clock-freq = <149999863>;
		xlnx,name = "versal_cips_0_pspmc_0_psv_ttc_2";
		xlnx,ttc-clk0-clksrc = <0>;
	};
	&ttc3 {
		xlnx,ttc-clk2-clksrc = <0>;
		firewall-0 = <&lpd_xppu>;
		xlnx,rable = <0>;
		xlnx,ip-name = "psv_ttc";
		xlnx,ttc-clk1-clksrc = <0>;
		xlnx,ttc-clk0-freq-hz = <149999863>;
		xlnx,ttc-clk1-freq-hz = <149999863>;
		status = "okay";
		xlnx,ttc-board-interface = "custom";
		xlnx,ttc-clk2-freq-hz = <149999863>;
		xlnx,clock-freq = <149999863>;
		xlnx,name = "versal_cips_0_pspmc_0_psv_ttc_3";
		xlnx,ttc-clk0-clksrc = <0>;
	};
	&usb0 {
		xlnx,rable = <0>;
		status = "okay";
		xlnx,ip-name = "psv_usb";
		firewall-0 = <&lpd_xppu>;
		xlnx,name = "versal_cips_0_pspmc_0_psv_usb_0";
	};
	&dwc3_0 {
		xlnx,rable = <0>;
		xlnx,is-cache-coherent = <0>;
		status = "okay";
		bus-master-id = <&lpd_xppu 0x230>;
		xlnx,ip-name = "psv_usb_xhci";
		firewall-0 = <&lpd_xppu>;
		xlnx,name = "versal_cips_0_pspmc_0_psv_usb_xhci_0";
	};
	&mc0 {
		ranges = <0x0 0x00000000 0x0 0x80000000>, <0x0 0x40000 0x0 0x7ffc0000>, <0x00000008 0x00000000 0x00000001 0x80000000>;
		status = "okay";
	};
	&ddrmc_xmpu_0 {
		status = "okay";
	};
	&psv_pmc_0 {
		xlnx,addr-tag-bits = <0>;
		xlnx,d-axi = <1>;
		xlnx,m-axi-dc-thread-id-width = <1>;
		xlnx,m0-axis-protocol = "GENERIC";
		xlnx,dcache-force-tag-lutram = <0>;
		xlnx,interrupt-is-edge = <0>;
		xlnx,use-mmu = <0>;
		xlnx,m-axi-dp-exclusive-access = <0>;
		xlnx,use-reorder-instr = <1>;
		xlnx,m14-axis-protocol = "GENERIC";
		xlnx,use-div = <1>;
		xlnx,dc-axi-mon = <0>;
		xlnx,m-axi-ic-user-signals = <0>;
		xlnx,use-config-reset = <0>;
		xlnx,s14-axis-protocol = "GENERIC";
		xlnx,family = "elbert";
		xlnx,mmu-zones = <16>;
		xlnx,enable-discrete-ports = <0>;
		xlnx,d-lmb = <1>;
		xlnx,m-axi-dc-exclusive-access = <0>;
		xlnx,sco = <0>;
		xlnx,s9-axis-protocol = "GENERIC";
		xlnx,debug-interface = <0>;
		xlnx,use-ext-brk = <0>;
		xlnx,debug-enabled = <1>;
		xlnx,daddr-size = <32>;
		xlnx,s0-axis-data-width = <32>;
		xlnx,use-extended-fsl-instr = <0>;
		xlnx,m-axi-dc-user-signals = <0>;
		xlnx,reset-msr = <0x00000000>;
		xlnx,branch-target-cache-size = <0>;
		xlnx,s2-axis-data-width = <32>;
		bus-handle = <&amba>;
		xlnx,cache-byte-size = <8192>;
		xlnx,mmu-tlb-access = <3>;
		xlnx,s4-axis-data-width = <32>;
		xlnx,m-axi-ic-awuser-width = <5>;
		xlnx,s6-axis-data-width = <32>;
		xlnx,s4-axis-protocol = "GENERIC";
		xlnx,s8-axis-data-width = <32>;
		xlnx,use-dcache = <0>;
		xlnx,edk-special = "microblaze";
		xlnx,m-axi-dp-addr-width = <32>;
		xlnx,m-axi-ic-wuser-width = <1>;
		xlnx,i-axi = <0>;
		xlnx,icache-streams = <0>;
		xlnx,m-axi-dc-awuser-width = <5>;
		xlnx,pss-ref-clk-freq = <33333300>;
		xlnx,use-stack-protection = <1>;
		xlnx,m6-axis-protocol = "GENERIC";
		xlnx,num-sync-ff-dbg-clk = <1>;
		xlnx,m-axi-ip-data-width = <32>;
		d-cache-size = <8192>;
		xlnx,use-pcmp-instr = <1>;
		xlnx,icache-baseaddr = <0x00000000 0x00000000>;
		xlnx,area-optimized = <0>;
		xlnx,avoid-primitives = <0>;
		xlnx,m1-axis-protocol = "GENERIC";
		xlnx,i-lmb = <1>;
		xlnx,lockstep-select = <0>;
		xlnx,dcache-baseaddr = <0x00000000 0x00000000>;
		xlnx,dcache-data-width = <0>;
		xlnx,icache-force-tag-lutram = <0>;
		xlnx,m15-axis-protocol = "GENERIC";
		xlnx,use-branch-target-cache = <0>;
		xlnx,m-axi-ip-thread-id-width = <1>;
		xlnx,mmu-itlb-size = <2>;
		xlnx,number-of-pc-brk = <2>;
		xlnx,imprecise-exceptions = <0>;
		xlnx,m-axi-ic-buser-width = <1>;
		xlnx,m-axi-ic-addr-width = <32>;
		xlnx,s15-axis-protocol = "GENERIC";
		d-cache-highaddr = <0x000000003FFFFFFF>;
		xlnx,m10-axis-protocol = "GENERIC";
		xlnx,optimization = <0>;
		xlnx,m-axi-ic-aruser-width = <5>;
		xlnx,d-lmb-mon = <0>;
		xlnx,s10-axis-protocol = "GENERIC";
		xlnx,m-axi-ic-ruser-width = <1>;
		xlnx,s5-axis-protocol = "GENERIC";
		xlnx,fault-tolerant = <1>;
		d-cache-line-size = <16>;
		xlnx,m-axi-dc-aruser-width = <5>;
		xlnx,mmu-privileged-instr = <0>;
		xlnx,m-axi-i-bus-exception = <0>;
		xlnx,reset-msr-eip = <0>;
		xlnx,endianness = <1>;
		xlnx,reset-msr-ice = <0>;
		xlnx,dp-axi-mon = <0>;
		xlnx,s10-axis-data-width = <32>;
		xlnx,s0-axis-protocol = "GENERIC";
		xlnx,s12-axis-data-width = <32>;
		xlnx,m7-axis-protocol = "GENERIC";
		xlnx,s14-axis-data-width = <32>;
		xlnx,m-axi-d-bus-exception = <1>;
		xlnx,reset-msr-bip = <1>;
		xlnx,debug-external-trace = <0>;
		xlnx,addr-size = <32>;
		xlnx,m-axi-ic-user-value = <31>;
		xlnx,m1-axis-data-width = <32>;
		xlnx,debug-event-counters = <5>;
		xlnx,m3-axis-data-width = <32>;
		xlnx,fpu-exception = <0>;
		xlnx,m2-axis-protocol = "GENERIC";
		xlnx,m5-axis-data-width = <32>;
		xlnx,m7-axis-data-width = <32>;
		xlnx,edk-iptype = "PROCESSOR";
		xlnx,debug-latency-counters = <1>;
		xlnx,interconnect = <2>;
		xlnx,m9-axis-data-width = <32>;
		xlnx,edge-is-positive = <1>;
		xlnx,use-icache = <0>;
		xlnx,async-wakeup = <3>;
		xlnx,m10-axis-data-width = <32>;
		xlnx,m12-axis-data-width = <32>;
		xlnx,use-ext-nm-brk = <0>;
		xlnx,m11-axis-protocol = "GENERIC";
		xlnx,m14-axis-data-width = <32>;
		xlnx,icache-always-used = <0>;
		xlnx,ic-axi-mon = <0>;
		xlnx,num-sync-ff-clk-irq = <1>;
		xlnx,freq = <320000000>;
		xlnx,lockstep-master = <0>;
		xlnx,s11-axis-protocol = "GENERIC";
		xlnx,use-msr-instr = <1>;
		xlnx,s6-axis-protocol = "GENERIC";
		xlnx,iaddr-size = <32>;
		xlnx,interrupt-mon = <0>;
		xlnx,m-axi-dc-data-width = <32>;
		xlnx,dynamic-bus-sizing = <0>;
		xlnx,icache-highaddr = <0x00000000 0x3FFFFFFF>;
		xlnx,number-of-wr-addr-brk = <1>;
		xlnx,use-interrupt = <1>;
		xlnx,m-axi-ip-addr-width = <32>;
		xlnx,async-interrupt = <1>;
		xlnx,pc-width = <32>;
		xlnx,icache-victims = <0>;
		xlnx,reset-msr-ee = <0>;
		xlnx,s1-axis-protocol = "GENERIC";
		xlnx,m8-axis-protocol = "GENERIC";
		i-cache-baseaddr = <0x0000000000000000>;
		xlnx,dcache-highaddr = <0x00000000 0x3FFFFFFF>;
		xlnx,i-lmb-mon = <0>;
		xlnx,dcache-byte-size = <8192>;
		xlnx,m-axi-dp-thread-id-width = <1>;
		xlnx,data-size = <32>;
		xlnx,m-axi-dc-wuser-width = <1>;
		xlnx,fsl-exception = <0>;
		xlnx,m3-axis-protocol = "GENERIC";
		xlnx,s1-axis-data-width = <32>;
		xlnx,dcache-use-writeback = <0>;
		xlnx,div-zero-exception = <1>;
		xlnx,s3-axis-data-width = <32>;
		xlnx,base-vectors = <0x00000000 0xF0240000>;
		xlnx,icache-line-len = <4>;
		xlnx,s5-axis-data-width = <32>;
		xlnx,s7-axis-data-width = <32>;
		xlnx,use-barrel = <1>;
		xlnx,s9-axis-data-width = <32>;
		xlnx,allow-dcache-wr = <1>;
		xlnx,g-use-exceptions = <1>;
		xlnx,dcache-line-len = <4>;
		xlnx,m12-axis-protocol = "GENERIC";
		xlnx,num-sync-ff-clk = <2>;
		i-cache-size = <8192>;
		xlnx,instance = "design_1_microblaze_0_0";
		xlnx,reset-msr-ie = <0>;
		xlnx,s12-axis-protocol = "GENERIC";
		xlnx,dcache-addr-tag = <0>;
		xlnx,m-axi-ic-thread-id-width = <1>;
		xlnx,number-of-rd-addr-brk = <1>;
		xlnx,m-axi-dc-buser-width = <1>;
		xlnx,s7-axis-protocol = "GENERIC";
		xlnx,lockstep-slave = <0>;
		xlnx,debug-profile-size = <0>;
		xlnx,s2-axis-protocol = "GENERIC";
		xlnx,m9-axis-protocol = "GENERIC";
		xlnx,debug-counter-width = <32>;
		xlnx,icache-data-width = <0>;
		xlnx,m-axi-dc-ruser-width = <1>;
		xlnx,reset-msr-dce = <0>;
		xlnx,rable = <0>;
		xlnx,ip-name = "psv_pmc";
		xlnx,ip-axi-mon = <0>;
		xlnx,m-axi-dp-data-width = <32>;
		xlnx,m4-axis-protocol = "GENERIC";
		xlnx,dcache-always-used = <0>;
		xlnx,ill-opcode-exception = <1>;
		xlnx,trace = <1>;
		xlnx,pvr = <2>;
		xlnx,debug-trace-size = <8192>;
		i-cache-line-size = <16>;
		xlnx,m13-axis-protocol = "GENERIC";
		xlnx,s11-axis-data-width = <32>;
		xlnx,m-axi-dc-addr-width = <32>;
		xlnx,s13-axis-data-width = <32>;
		xlnx,ecc-use-ce-exception = <0>;
		xlnx,opcode-0x0-illegal = <1>;
		xlnx,pvr-user2 = <0x00000000>;
		xlnx,s15-axis-data-width = <32>;
		xlnx,s13-axis-protocol = "GENERIC";
		xlnx,m0-axis-data-width = <32>;
		i-cache-highaddr = <0x000000003FFFFFFF>;
		xlnx,s8-axis-protocol = "GENERIC";
		xlnx,m2-axis-data-width = <32>;
		xlnx,num-sync-ff-clk-debug = <2>;
		xlnx,allow-icache-wr = <1>;
		xlnx,m4-axis-data-width = <32>;
		xlnx,g-template-list = <0>;
		xlnx,m6-axis-data-width = <32>;
		xlnx,m-axi-ic-data-width = <32>;
		xlnx,m8-axis-data-width = <32>;
		xlnx,use-hw-mul = <2>;
		xlnx,use-fpu = <0>;
		xlnx,s3-axis-protocol = "GENERIC";
		xlnx,use-non-secure = <0>;
		d-cache-baseaddr = <0x0000000000000000>;
		xlnx,m11-axis-data-width = <32>;
		xlnx,m13-axis-data-width = <32>;
		xlnx,instr-size = <32>;
		xlnx,m15-axis-data-width = <32>;
		xlnx,mmu-dtlb-size = <4>;
		xlnx,fsl-links = <0>;
		xlnx,m5-axis-protocol = "GENERIC";
		xlnx,dcache-victims = <0>;
		xlnx,unaligned-exceptions = <1>;
		xlnx,m-axi-dc-user-value = <31>;
	};
	&amba {
		#address-cells = <2>;
		model = "xlnx,versal";
		#size-cells = <2>;
		versal_cips_0_pspmc_0_psv_apu_0: psv_apu@fd5c0000 {
			xlnx,rable = <0>;
			compatible = "xlnx,psv-apu-1.0";
			status = "okay";
			xlnx,ip-name = "psv_apu";
			reg = <0x0 0xfd5c0000 0x0 0x10000>;
			firewall-0 = <&fpd_xmpu>;
			xlnx,name = "versal_cips_0_pspmc_0_psv_apu_0";
		};
		versal_cips_0_pspmc_0_psv_coresight_a720_cti: psv_coresight_a720_cti@f0d10000 {
			xlnx,rable = <0>;
			compatible = "xlnx,psv-coresight-a720-cti-1.0";
			status = "okay";
			xlnx,ip-name = "psv_coresight_a720_cti";
			reg = <0x0 0xf0d10000 0x0 0x10000>;
			xlnx,name = "versal_cips_0_pspmc_0_psv_coresight_a720_cti";
		};
		versal_cips_0_pspmc_0_psv_coresight_a720_dbg: psv_coresight_a720_dbg@f0d00000 {
			xlnx,rable = <0>;
			compatible = "xlnx,psv-coresight-a720-dbg-1.0";
			status = "okay";
			xlnx,ip-name = "psv_coresight_a720_dbg";
			reg = <0x0 0xf0d00000 0x0 0x10000>;
			firewall-0 = <&pmc_xppu>;
			xlnx,name = "versal_cips_0_pspmc_0_psv_coresight_a720_dbg";
		};
		versal_cips_0_pspmc_0_psv_coresight_a720_etm: psv_coresight_a720_etm@f0d30000 {
			xlnx,rable = <0>;
			compatible = "xlnx,psv-coresight-a720-etm-1.0";
			status = "okay";
			xlnx,ip-name = "psv_coresight_a720_etm";
			reg = <0x0 0xf0d30000 0x0 0x10000>;
			xlnx,name = "versal_cips_0_pspmc_0_psv_coresight_a720_etm";
		};
		versal_cips_0_pspmc_0_psv_coresight_a720_pmu: psv_coresight_a720_pmu@f0d20000 {
			xlnx,rable = <0>;
			compatible = "xlnx,psv-coresight-a720-pmu-1.0";
			status = "okay";
			xlnx,ip-name = "psv_coresight_a720_pmu";
			reg = <0x0 0xf0d20000 0x0 0x10000>;
			xlnx,name = "versal_cips_0_pspmc_0_psv_coresight_a720_pmu";
		};
		versal_cips_0_pspmc_0_psv_coresight_a721_cti: psv_coresight_a721_cti@f0d50000 {
			xlnx,rable = <0>;
			compatible = "xlnx,psv-coresight-a721-cti-1.0";
			status = "okay";
			xlnx,ip-name = "psv_coresight_a721_cti";
			reg = <0x0 0xf0d50000 0x0 0x10000>;
			xlnx,name = "versal_cips_0_pspmc_0_psv_coresight_a721_cti";
		};
		versal_cips_0_pspmc_0_psv_coresight_a721_dbg: psv_coresight_a721_dbg@f0d40000 {
			xlnx,rable = <0>;
			compatible = "xlnx,psv-coresight-a721-dbg-1.0";
			status = "okay";
			xlnx,ip-name = "psv_coresight_a721_dbg";
			reg = <0x0 0xf0d40000 0x0 0x10000>;
			xlnx,name = "versal_cips_0_pspmc_0_psv_coresight_a721_dbg";
		};
		versal_cips_0_pspmc_0_psv_coresight_a721_etm: psv_coresight_a721_etm@f0d70000 {
			xlnx,rable = <0>;
			compatible = "xlnx,psv-coresight-a721-etm-1.0";
			status = "okay";
			xlnx,ip-name = "psv_coresight_a721_etm";
			reg = <0x0 0xf0d70000 0x0 0x10000>;
			xlnx,name = "versal_cips_0_pspmc_0_psv_coresight_a721_etm";
		};
		versal_cips_0_pspmc_0_psv_coresight_a721_pmu: psv_coresight_a721_pmu@f0d60000 {
			xlnx,rable = <0>;
			compatible = "xlnx,psv-coresight-a721-pmu-1.0";
			status = "okay";
			xlnx,ip-name = "psv_coresight_a721_pmu";
			reg = <0x0 0xf0d60000 0x0 0x10000>;
			xlnx,name = "versal_cips_0_pspmc_0_psv_coresight_a721_pmu";
		};
		versal_cips_0_pspmc_0_psv_coresight_apu_cti: psv_coresight_apu_cti@f0ca0000 {
			xlnx,rable = <0>;
			compatible = "xlnx,psv-coresight-apu-cti-1.0";
			status = "okay";
			xlnx,ip-name = "psv_coresight_apu_cti";
			reg = <0x0 0xf0ca0000 0x0 0x10000>;
			xlnx,name = "versal_cips_0_pspmc_0_psv_coresight_apu_cti";
		};
		versal_cips_0_pspmc_0_psv_coresight_apu_ela: psv_coresight_apu_ela@f0c60000 {
			xlnx,rable = <0>;
			compatible = "xlnx,psv-coresight-apu-ela-1.0";
			status = "okay";
			xlnx,ip-name = "psv_coresight_apu_ela";
			reg = <0x0 0xf0c60000 0x0 0x10000>;
			xlnx,name = "versal_cips_0_pspmc_0_psv_coresight_apu_ela";
		};
		versal_cips_0_pspmc_0_psv_coresight_apu_etf: psv_coresight_apu_etf@f0c30000 {
			xlnx,rable = <0>;
			compatible = "xlnx,psv-coresight-apu-etf-1.0";
			status = "okay";
			xlnx,ip-name = "psv_coresight_apu_etf";
			reg = <0x0 0xf0c30000 0x0 0x10000>;
			xlnx,name = "versal_cips_0_pspmc_0_psv_coresight_apu_etf";
		};
		versal_cips_0_pspmc_0_psv_coresight_apu_fun: psv_coresight_apu_fun@f0c20000 {
			xlnx,rable = <0>;
			compatible = "xlnx,psv-coresight-apu-fun-1.0";
			status = "okay";
			xlnx,ip-name = "psv_coresight_apu_fun";
			reg = <0x0 0xf0c20000 0x0 0x10000>;
			xlnx,name = "versal_cips_0_pspmc_0_psv_coresight_apu_fun";
		};
		versal_cips_0_pspmc_0_psv_coresight_cpm_atm: psv_coresight_cpm_atm@f0f80000 {
			xlnx,rable = <0>;
			compatible = "xlnx,psv-coresight-cpm-atm-1.0";
			status = "okay";
			xlnx,ip-name = "psv_coresight_cpm_atm";
			reg = <0x0 0xf0f80000 0x0 0x10000>;
			xlnx,name = "versal_cips_0_pspmc_0_psv_coresight_cpm_atm";
		};
		versal_cips_0_pspmc_0_psv_coresight_cpm_cti2a: psv_coresight_cpm_cti2a@f0fa0000 {
			xlnx,rable = <0>;
			compatible = "xlnx,psv-coresight-cpm-cti2a-1.0";
			status = "okay";
			xlnx,ip-name = "psv_coresight_cpm_cti2a";
			reg = <0x0 0xf0fa0000 0x0 0x10000>;
			xlnx,name = "versal_cips_0_pspmc_0_psv_coresight_cpm_cti2a";
		};
		versal_cips_0_pspmc_0_psv_coresight_cpm_cti2d: psv_coresight_cpm_cti2d@f0fd0000 {
			xlnx,rable = <0>;
			compatible = "xlnx,psv-coresight-cpm-cti2d-1.0";
			status = "okay";
			xlnx,ip-name = "psv_coresight_cpm_cti2d";
			reg = <0x0 0xf0fd0000 0x0 0x10000>;
			xlnx,name = "versal_cips_0_pspmc_0_psv_coresight_cpm_cti2d";
		};
		versal_cips_0_pspmc_0_psv_coresight_cpm_ela2a: psv_coresight_cpm_ela2a@f0f40000 {
			xlnx,rable = <0>;
			compatible = "xlnx,psv-coresight-cpm-ela2a-1.0";
			status = "okay";
			xlnx,ip-name = "psv_coresight_cpm_ela2a";
			reg = <0x0 0xf0f40000 0x0 0x10000>;
			xlnx,name = "versal_cips_0_pspmc_0_psv_coresight_cpm_ela2a";
		};
		versal_cips_0_pspmc_0_psv_coresight_cpm_ela2b: psv_coresight_cpm_ela2b@f0f50000 {
			xlnx,rable = <0>;
			compatible = "xlnx,psv-coresight-cpm-ela2b-1.0";
			status = "okay";
			xlnx,ip-name = "psv_coresight_cpm_ela2b";
			reg = <0x0 0xf0f50000 0x0 0x10000>;
			xlnx,name = "versal_cips_0_pspmc_0_psv_coresight_cpm_ela2b";
		};
		versal_cips_0_pspmc_0_psv_coresight_cpm_ela2c: psv_coresight_cpm_ela2c@f0f60000 {
			xlnx,rable = <0>;
			compatible = "xlnx,psv-coresight-cpm-ela2c-1.0";
			status = "okay";
			xlnx,ip-name = "psv_coresight_cpm_ela2c";
			reg = <0x0 0xf0f60000 0x0 0x10000>;
			xlnx,name = "versal_cips_0_pspmc_0_psv_coresight_cpm_ela2c";
		};
		versal_cips_0_pspmc_0_psv_coresight_cpm_ela2d: psv_coresight_cpm_ela2d@f0f70000 {
			xlnx,rable = <0>;
			compatible = "xlnx,psv-coresight-cpm-ela2d-1.0";
			status = "okay";
			xlnx,ip-name = "psv_coresight_cpm_ela2d";
			reg = <0x0 0xf0f70000 0x0 0x10000>;
			xlnx,name = "versal_cips_0_pspmc_0_psv_coresight_cpm_ela2d";
		};
		versal_cips_0_pspmc_0_psv_coresight_cpm_fun: psv_coresight_cpm_fun@f0f20000 {
			xlnx,rable = <0>;
			compatible = "xlnx,psv-coresight-cpm-fun-1.0";
			status = "okay";
			xlnx,ip-name = "psv_coresight_cpm_fun";
			reg = <0x0 0xf0f20000 0x0 0x10000>;
			xlnx,name = "versal_cips_0_pspmc_0_psv_coresight_cpm_fun";
		};
		versal_cips_0_pspmc_0_psv_coresight_cpm_rom: psv_coresight_cpm_rom@f0f00000 {
			xlnx,rable = <0>;
			compatible = "xlnx,psv-coresight-cpm-rom-1.0";
			status = "okay";
			xlnx,ip-name = "psv_coresight_cpm_rom";
			reg = <0x0 0xf0f00000 0x0 0x10000>;
			firewall-0 = <&pmc_xppu>;
			xlnx,name = "versal_cips_0_pspmc_0_psv_coresight_cpm_rom";
		};
		versal_cips_0_pspmc_0_psv_coresight_fpd_atm: psv_coresight_fpd_atm@f0b80000 {
			xlnx,rable = <0>;
			compatible = "xlnx,psv-coresight-fpd-atm-1.0";
			status = "okay";
			xlnx,ip-name = "psv_coresight_fpd_atm";
			reg = <0x0 0xf0b80000 0x0 0x10000>;
			xlnx,name = "versal_cips_0_pspmc_0_psv_coresight_fpd_atm";
		};
		versal_cips_0_pspmc_0_psv_coresight_fpd_stm: psv_coresight_fpd_stm@f0b70000 {
			xlnx,rable = <0>;
			compatible = "xlnx,psv-coresight-fpd-stm-1.0";
			status = "okay";
			xlnx,ip-name = "psv_coresight_fpd_stm";
			reg = <0x0 0xf0b70000 0x0 0x10000>;
			xlnx,name = "versal_cips_0_pspmc_0_psv_coresight_fpd_stm";
		};
		versal_cips_0_pspmc_0_psv_coresight_lpd_atm: psv_coresight_lpd_atm@f0980000 {
			xlnx,rable = <0>;
			compatible = "xlnx,psv-coresight-lpd-atm-1.0";
			status = "okay";
			xlnx,ip-name = "psv_coresight_lpd_atm";
			reg = <0x0 0xf0980000 0x0 0x10000>;
			xlnx,name = "versal_cips_0_pspmc_0_psv_coresight_lpd_atm";
		};
		versal_cips_0_pspmc_0_psv_cpm: psv_cpm@fc000000 {
			xlnx,rable = <0>;
			compatible = "xlnx,psv-cpm-1.0";
			status = "okay";
			xlnx,ip-name = "psv_cpm";
			reg = <0x0 0xfc000000 0x0 0x1000000>;
			firewall-0 = <&lpd_xppu>;
			xlnx,name = "versal_cips_0_pspmc_0_psv_cpm";
		};
		versal_cips_0_pspmc_0_psv_crf_0: psv_crf@fd1a0000 {
			xlnx,rable = <0>;
			compatible = "xlnx,psv-crf-1.0" , "xlnx,ctrlregs";
			status = "okay";
			xlnx,ip-name = "psv_crf";
			reg = <0x0 0xfd1a0000 0x0 0x140000>;
			firewall-0 = <&fpd_xmpu>;
			xlnx,name = "versal_cips_0_pspmc_0_psv_crf_0";
		};
		versal_cips_0_pspmc_0_psv_crl_0: psv_crl@ff5e0000 {
			xlnx,rable = <0>;
			compatible = "xlnx,psv-crl-1.0" , "xlnx,ctrlregs";
			status = "okay";
			xlnx,ip-name = "psv_crl";
			reg = <0x0 0xff5e0000 0x0 0x300000>;
			firewall-0 = <&lpd_xppu>;
			xlnx,name = "versal_cips_0_pspmc_0_psv_crl_0";
		};
		versal_cips_0_pspmc_0_psv_crp_0: psv_crp@f1260000 {
			xlnx,rable = <0>;
			compatible = "xlnx,psv-crp-1.0" , "xlnx,ctrlregs";
			status = "okay";
			xlnx,ip-name = "psv_crp";
			reg = <0x0 0xf1260000 0x0 0x10000>;
			firewall-0 = <&pmc_xppu>;
			xlnx,name = "versal_cips_0_pspmc_0_psv_crp_0";
		};
		versal_cips_0_pspmc_0_psv_fpd_afi_0: psv_fpd_afi@fd360000 {
			xlnx,rable = <0>;
			compatible = "xlnx,psv-fpd-afi-1.0" , "xlnx,ctrlregs";
			status = "okay";
			xlnx,ip-name = "psv_fpd_afi";
			reg = <0x0 0xfd360000 0x0 0x10000>;
			firewall-0 = <&fpd_xmpu>;
			xlnx,name = "versal_cips_0_pspmc_0_psv_fpd_afi_0";
		};
		versal_cips_0_pspmc_0_psv_fpd_afi_2: psv_fpd_afi@fd380000 {
			xlnx,rable = <0>;
			compatible = "xlnx,psv-fpd-afi-1.0" , "xlnx,ctrlregs";
			status = "okay";
			xlnx,ip-name = "psv_fpd_afi";
			reg = <0x0 0xfd380000 0x0 0x10000>;
			firewall-0 = <&fpd_xmpu>;
			xlnx,name = "versal_cips_0_pspmc_0_psv_fpd_afi_2";
		};
		versal_cips_0_pspmc_0_psv_fpd_afi_mem_0: psv_fpd_afi_mem@a4000000 {
			xlnx,rable = <0>;
			compatible = "xlnx,psv-fpd-afi-mem-1.0";
			status = "okay";
			xlnx,ip-name = "psv_fpd_afi_mem";
			reg = <0x0 0xa4000000 0x0 0xc000000>;
			firewall-0 = <&fpd_xmpu>;
			xlnx,name = "versal_cips_0_pspmc_0_psv_fpd_afi_mem_0";
		};
		versal_cips_0_pspmc_0_psv_fpd_afi_mem_2: psv_fpd_afi_mem@b0000000 {
			xlnx,rable = <0>;
			compatible = "xlnx,psv-fpd-afi-mem-1.0";
			status = "okay";
			xlnx,ip-name = "psv_fpd_afi_mem";
			reg = <0x0 0xb0000000 0x0 0x10000000>;
			firewall-0 = <&fpd_xmpu>;
			xlnx,name = "versal_cips_0_pspmc_0_psv_fpd_afi_mem_2";
		};
		versal_cips_0_pspmc_0_psv_fpd_cci_0: psv_fpd_cci@fd5e0000 {
			xlnx,rable = <0>;
			compatible = "xlnx,psv-fpd-cci-1.0";
			status = "okay";
			xlnx,ip-name = "psv_fpd_cci";
			reg = <0x0 0xfd5e0000 0x0 0x10000>;
			firewall-0 = <&fpd_xmpu>;
			xlnx,name = "versal_cips_0_pspmc_0_psv_fpd_cci_0";
		};
		versal_cips_0_pspmc_0_psv_fpd_gpv_0: psv_fpd_gpv@fd700000 {
			xlnx,rable = <0>;
			compatible = "xlnx,psv-fpd-gpv-1.0" , "xlnx,ctrlregs";
			status = "okay";
			xlnx,ip-name = "psv_fpd_gpv";
			reg = <0x0 0xfd700000 0x0 0x100000>;
			firewall-0 = <&fpd_xmpu>;
			xlnx,name = "versal_cips_0_pspmc_0_psv_fpd_gpv_0";
		};
		versal_cips_0_pspmc_0_psv_fpd_maincci_0: psv_fpd_maincci@fd000000 {
			xlnx,rable = <0>;
			compatible = "xlnx,psv-fpd-maincci-1.0";
			status = "okay";
			xlnx,ip-name = "psv_fpd_maincci";
			reg = <0x0 0xfd000000 0x0 0x100000>;
			firewall-0 = <&fpd_xmpu>;
			xlnx,name = "versal_cips_0_pspmc_0_psv_fpd_maincci_0";
		};
		versal_cips_0_pspmc_0_psv_fpd_slcr_0: psv_fpd_slcr@fd610000 {
			xlnx,rable = <0>;
			compatible = "xlnx,psv-fpd-slcr-1.0" , "xlnx,ctrlregs";
			status = "okay";
			xlnx,ip-name = "psv_fpd_slcr";
			reg = <0x0 0xfd610000 0x0 0x10000>;
			firewall-0 = <&fpd_xmpu>;
			xlnx,name = "versal_cips_0_pspmc_0_psv_fpd_slcr_0";
		};
		versal_cips_0_pspmc_0_psv_fpd_slcr_secure_0: psv_fpd_slcr_secure@fd690000 {
			xlnx,rable = <0>;
			compatible = "xlnx,psv-fpd-slcr-secure-1.0" , "xlnx,ctrlregs";
			status = "okay";
			xlnx,ip-name = "psv_fpd_slcr_secure";
			reg = <0x0 0xfd690000 0x0 0x10000>;
			firewall-0 = <&fpd_xmpu>;
			xlnx,name = "versal_cips_0_pspmc_0_psv_fpd_slcr_secure_0";
		};
		versal_cips_0_pspmc_0_psv_fpd_smmu_0: psv_fpd_smmu@fd5f0000 {
			xlnx,rable = <0>;
			compatible = "xlnx,psv-fpd-smmu-1.0";
			status = "okay";
			xlnx,ip-name = "psv_fpd_smmu";
			reg = <0x0 0xfd5f0000 0x0 0x10000>;
			firewall-0 = <&fpd_xmpu>;
			xlnx,name = "versal_cips_0_pspmc_0_psv_fpd_smmu_0";
		};
		versal_cips_0_pspmc_0_psv_ipi_buffer: psv_ipi_buffer@ff3f0000 {
			xlnx,rable = <0>;
			compatible = "xlnx,psv-ipi-buffer-1.0";
			status = "okay";
			xlnx,ip-name = "psv_ipi_buffer";
			reg = <0x0 0xff3f0000 0x0 0x1000>;
			firewall-0 = <&lpd_xppu>;
			xlnx,name = "versal_cips_0_pspmc_0_psv_ipi_buffer";
		};
		versal_cips_0_pspmc_0_psv_lpd_afi_0: psv_lpd_afi@ff9b0000 {
			xlnx,rable = <0>;
			compatible = "xlnx,psv-lpd-afi-1.0" , "xlnx,ctrlregs";
			status = "okay";
			xlnx,ip-name = "psv_lpd_afi";
			reg = <0x0 0xff9b0000 0x0 0x10000>;
			firewall-0 = <&lpd_xppu>;
			xlnx,name = "versal_cips_0_pspmc_0_psv_lpd_afi_0";
		};
		versal_cips_0_pspmc_0_psv_lpd_afi_mem_0: psv_lpd_afi_mem@80000000 {
			xlnx,rable = <0>;
			compatible = "xlnx,psv-lpd-afi-mem-1.0";
			status = "okay";
			xlnx,ip-name = "psv_lpd_afi_mem";
			reg = <0x0 0x80000000 0x0 0x20000000>;
			firewall-0 = <&fpd_xmpu>;
			xlnx,name = "versal_cips_0_pspmc_0_psv_lpd_afi_mem_0";
		};
		versal_cips_0_pspmc_0_psv_lpd_iou_secure_slcr_0: psv_lpd_iou_secure_slcr@ff0a0000 {
			xlnx,rable = <0>;
			compatible = "xlnx,psv-lpd-iou-secure-slcr-1.0" , "xlnx,ctrlregs";
			status = "okay";
			xlnx,ip-name = "psv_lpd_iou_secure_slcr";
			reg = <0x0 0xff0a0000 0x0 0x10000>;
			firewall-0 = <&lpd_xppu>;
			xlnx,name = "versal_cips_0_pspmc_0_psv_lpd_iou_secure_slcr_0";
		};
		versal_cips_0_pspmc_0_psv_lpd_iou_slcr_0: psv_lpd_iou_slcr@ff080000 {
			xlnx,rable = <0>;
			compatible = "xlnx,psv-lpd-iou-slcr-1.0" , "xlnx,ctrlregs";
			status = "okay";
			xlnx,ip-name = "psv_lpd_iou_slcr";
			reg = <0x0 0xff080000 0x0 0x20000>;
			firewall-0 = <&lpd_xppu>;
			xlnx,name = "versal_cips_0_pspmc_0_psv_lpd_iou_slcr_0";
		};
		versal_cips_0_pspmc_0_psv_lpd_slcr_0: psv_lpd_slcr@ff410000 {
			xlnx,rable = <0>;
			compatible = "xlnx,psv-lpd-slcr-1.0" , "xlnx,ctrlregs";
			status = "okay";
			xlnx,ip-name = "psv_lpd_slcr";
			reg = <0x0 0xff410000 0x0 0x100000>;
			firewall-0 = <&lpd_xppu>;
			xlnx,name = "versal_cips_0_pspmc_0_psv_lpd_slcr_0";
		};
		versal_cips_0_pspmc_0_psv_lpd_slcr_secure_0: psv_lpd_slcr_secure@ff510000 {
			xlnx,rable = <0>;
			compatible = "xlnx,psv-lpd-slcr-secure-1.0" , "xlnx,ctrlregs";
			status = "okay";
			xlnx,ip-name = "psv_lpd_slcr_secure";
			reg = <0x0 0xff510000 0x0 0x40000>;
			firewall-0 = <&lpd_xppu>;
			xlnx,name = "versal_cips_0_pspmc_0_psv_lpd_slcr_secure_0";
		};
		versal_cips_0_pspmc_0_psv_ocm_ctrl: psv_ocm@ff960000 {
			xlnx,rable = <0>;
			compatible = "xlnx,psv-ocm-1.0";
			status = "okay";
			power-domains = <&versal_firmware 0x18314007>;
			xlnx,ip-name = "psv_ocm";
			reg = <0x0 0xff960000 0x0 0x10000>;
			firewall-0 = <&lpd_xppu>;
			xlnx,name = "versal_cips_0_pspmc_0_psv_ocm_ctrl";
		};
		versal_cips_0_pspmc_0_psv_pmc_aes: psv_pmc_aes@f11e0000 {
			xlnx,rable = <0>;
			compatible = "xlnx,psv-pmc-aes-1.0" , "xlnx,ctrlregs";
			status = "okay";
			xlnx,ip-name = "psv_pmc_aes";
			reg = <0x0 0xf11e0000 0x0 0x10000>;
			firewall-0 = <&pmc_xppu>;
			xlnx,name = "versal_cips_0_pspmc_0_psv_pmc_aes";
		};
		versal_cips_0_pspmc_0_psv_pmc_bbram_ctrl: psv_pmc_bbram_ctrl@f11f0000 {
			xlnx,rable = <0>;
			compatible = "xlnx,psv-pmc-bbram-ctrl-1.0" , "xlnx,ctrlregs";
			status = "okay";
			xlnx,ip-name = "psv_pmc_bbram_ctrl";
			reg = <0x0 0xf11f0000 0x0 0x10000>;
			firewall-0 = <&pmc_xppu>;
			xlnx,name = "versal_cips_0_pspmc_0_psv_pmc_bbram_ctrl";
		};
		versal_cips_0_pspmc_0_psv_pmc_cfi_cframe_0: psv_pmc_cfi_cframe@f12d0000 {
			xlnx,rable = <0>;
			compatible = "xlnx,psv-pmc-cfi-cframe-1.0" , "xlnx,ctrlregs";
			status = "okay";
			xlnx,ip-name = "psv_pmc_cfi_cframe";
			reg = <0x0 0xf12d0000 0x0 0x1000>;
			firewall-0 = <&pmc_xppu>;
			xlnx,name = "versal_cips_0_pspmc_0_psv_pmc_cfi_cframe_0";
		};
		versal_cips_0_pspmc_0_psv_pmc_cfu_apb_0: psv_pmc_cfu_apb@f12b0000 {
			xlnx,rable = <0>;
			compatible = "xlnx,psv-pmc-cfu-apb-1.0" , "xlnx,ctrlregs";
			status = "okay";
			xlnx,ip-name = "psv_pmc_cfu_apb";
			reg = <0x0 0xf12b0000 0x0 0x10000>;
			firewall-0 = <&pmc_xppu>;
			xlnx,name = "versal_cips_0_pspmc_0_psv_pmc_cfu_apb_0";
		};
		versal_cips_0_pspmc_0_psv_pmc_efuse_cache: psv_pmc_efuse_cache@f1250000 {
			xlnx,rable = <0>;
			compatible = "xlnx,psv-pmc-efuse-cache-1.0" , "xlnx,ctrlregs";
			status = "okay";
			xlnx,ip-name = "psv_pmc_efuse_cache";
			reg = <0x0 0xf1250000 0x0 0x10000>;
			firewall-0 = <&pmc_xppu>;
			xlnx,name = "versal_cips_0_pspmc_0_psv_pmc_efuse_cache";
		};
		versal_cips_0_pspmc_0_psv_pmc_efuse_ctrl: psv_pmc_efuse_ctrl@f1240000 {
			xlnx,rable = <0>;
			compatible = "xlnx,psv-pmc-efuse-ctrl-1.0" , "xlnx,ctrlregs";
			status = "okay";
			xlnx,ip-name = "psv_pmc_efuse_ctrl";
			reg = <0x0 0xf1240000 0x0 0x10000>;
			firewall-0 = <&pmc_xppu>;
			xlnx,name = "versal_cips_0_pspmc_0_psv_pmc_efuse_ctrl";
		};
		versal_cips_0_pspmc_0_psv_pmc_global_0: psv_pmc_global@f1110000 {
			xlnx,rable = <0>;
			compatible = "xlnx,psv-pmc-global-1.0" , "xlnx,ctrlregs";
			status = "okay";
			xlnx,ip-name = "psv_pmc_global";
			reg = <0x0 0xf1110000 0x0 0x50000>;
			firewall-0 = <&pmc_xppu>;
			xlnx,npi-scan = <0>;
			xlnx,event-log = <0>;
			xlnx,cram-scan = <0>;
			xlnx,name = "versal_cips_0_pspmc_0_psv_pmc_global_0";
		};
		versal_cips_0_pspmc_0_psv_pmc_ppu1_mdm_0: psv_pmc_ppu1_mdm@f0310000 {
			xlnx,rable = <0>;
			compatible = "xlnx,psv-pmc-ppu1-mdm-1.0" , "xlnx,ctrlregs";
			status = "okay";
			xlnx,ip-name = "psv_pmc_ppu1_mdm";
			reg = <0x0 0xf0310000 0x0 0x8000>;
			firewall-0 = <&pmc_xppu>;
			xlnx,name = "versal_cips_0_pspmc_0_psv_pmc_ppu1_mdm_0";
		};
		versal_cips_0_pspmc_0_psv_pmc_ram: psv_pmc_ram@f2000000 {
			xlnx,rable = <0>;
			compatible = "xlnx,psv-pmc-ram-1.0";
			status = "okay";
			xlnx,ip-name = "psv_pmc_ram";
			reg = <0x0 0xf2000000 0x0 0x20000>;
			firewall-0 = <&pmc_xppu>;
			xlnx,name = "versal_cips_0_pspmc_0_psv_pmc_ram";
		};
		versal_cips_0_pspmc_0_psv_pmc_ram_data_cntlr: ram_data_cntlr@f0240000 {
			xlnx,write-access = <2>;
			xlnx,family = "kintex7";
			xlnx,edk-special = "BRAM_CTRL";
			compatible = "xlnx,ram-data-cntlr-1.0";
			xlnx,ecc-onoff-register = <1>;
			xlnx,ecc-onoff-reset-value = <1>;
			xlnx,s-axi-ctrl-protocol = "AXI4LITE";
			xlnx,highaddr = <0xF027FFFF>;
			xlnx,s-axi-ctrl-highaddr = <0xF0282FFF>;
			xlnx,mask = <0xffffffff 0xFFFFE000>;
			firewall-0 = <&pmc_xppu>;
			xlnx,mask1 = <0xffffffff 0xFFFFE000>;
			xlnx,s-axi-ctrl-aclk-freq-hz = <100000000>;
			xlnx,rable = <0>;
			xlnx,mask2 = <0x00000000 0x00800000>;
			xlnx,fault-inject = <1>;
			xlnx,mask3 = <0x00000000 0x00800000>;
			xlnx,ip-name = "ram_data_cntlr";
			xlnx,num-lmb = <2>;
			reg = <0x0 0xf0240000 0x0 0x20000>;
			xlnx,s-axi-ctrl-addr-width = <32>;
			xlnx,ecc-status-registers = <1>;
			xlnx,ce-counter-width = <16>;
			xlnx,ecc = <1>;
			xlnx,lmb-dwidth = <32>;
			xlnx,interconnect = <2>;
			xlnx,edk-iptype = "PERIPHERAL";
			xlnx,ce-failing-registers = <1>;
			xlnx,ue-failing-registers = <1>;
			status = "okay";
			xlnx,baseaddr = <0xF0260000>;
			xlnx,s-axi-ctrl-baseaddr = <0xF0282000>;
			xlnx,s-axi-ctrl-data-width = <32>;
			xlnx,bram-awidth = <32>;
			xlnx,lmb-awidth = <32>;
			xlnx,name = "versal_cips_0_pspmc_0_psv_pmc_ram_data_cntlr";
		};
		versal_cips_0_pspmc_0_psv_pmc_ram_instr_cntlr: ram_instr_cntlr@f0200000 {
			xlnx,write-access = <2>;
			xlnx,family = "kintex7";
			xlnx,edk-special = "BRAM_CTRL";
			compatible = "xlnx,ram-instr-cntlr-1.0";
			xlnx,ecc-onoff-register = <1>;
			xlnx,ecc-onoff-reset-value = <1>;
			xlnx,s-axi-ctrl-protocol = "AXI4LITE";
			xlnx,highaddr = <0xF025FFFF>;
			xlnx,s-axi-ctrl-highaddr = <0xF0281FFF>;
			xlnx,mask = <0x00000000 0xFFFE0000>;
			firewall-0 = <&pmc_xppu>;
			xlnx,mask1 = <0x00000000 0xFFFE0000>;
			xlnx,s-axi-ctrl-aclk-freq-hz = <100000000>;
			xlnx,rable = <0>;
			xlnx,mask2 = <0x00000000 0x00800000>;
			xlnx,fault-inject = <1>;
			xlnx,mask3 = <0x00000000 0x00800000>;
			xlnx,ip-name = "ram_instr_cntlr";
			xlnx,num-lmb = <2>;
			reg = <0x0 0xf0200000 0x0 0x40000>;
			xlnx,s-axi-ctrl-addr-width = <32>;
			xlnx,ecc-status-registers = <1>;
			xlnx,ce-counter-width = <16>;
			xlnx,ecc = <1>;
			xlnx,lmb-dwidth = <32>;
			xlnx,interconnect = <2>;
			xlnx,edk-iptype = "PERIPHERAL";
			xlnx,ce-failing-registers = <1>;
			xlnx,ue-failing-registers = <1>;
			status = "okay";
			xlnx,baseaddr = <0xF0240000>;
			xlnx,s-axi-ctrl-baseaddr = <0xF0281000>;
			xlnx,s-axi-ctrl-data-width = <32>;
			xlnx,bram-awidth = <32>;
			xlnx,lmb-awidth = <32>;
			xlnx,name = "versal_cips_0_pspmc_0_psv_pmc_ram_instr_cntlr";
		};
		versal_cips_0_pspmc_0_psv_pmc_ram_npi: psv_pmc_ram_npi@f6000000 {
			xlnx,rable = <0>;
			compatible = "xlnx,psv-pmc-ram-npi-1.0";
			status = "okay";
			xlnx,ip-name = "psv_pmc_ram_npi";
			reg = <0x0 0xf6000000 0x0 0x2000000>;
			firewall-0 = <&pmc_xppu>;
			xlnx,name = "versal_cips_0_pspmc_0_psv_pmc_ram_npi";
		};
		versal_cips_0_pspmc_0_psv_pmc_rsa: psv_pmc_rsa@f1200000 {
			xlnx,rable = <0>;
			compatible = "xlnx,psv-pmc-rsa-1.0" , "xlnx,ctrlregs";
			status = "okay";
			xlnx,ip-name = "psv_pmc_rsa";
			reg = <0x0 0xf1200000 0x0 0x10000>;
			firewall-0 = <&pmc_xppu>;
			xlnx,name = "versal_cips_0_pspmc_0_psv_pmc_rsa";
		};
		versal_cips_0_pspmc_0_psv_pmc_sha: psv_pmc_sha@f1210000 {
			xlnx,rable = <0>;
			compatible = "xlnx,psv-pmc-sha-1.0" , "xlnx,ctrlregs";
			status = "okay";
			xlnx,ip-name = "psv_pmc_sha";
			reg = <0x0 0xf1210000 0x0 0x10000>;
			firewall-0 = <&pmc_xppu>;
			xlnx,name = "versal_cips_0_pspmc_0_psv_pmc_sha";
		};
		versal_cips_0_pspmc_0_psv_pmc_slave_boot: psv_pmc_slave_boot@f1220000 {
			xlnx,rable = <0>;
			xlnx,device-id = <0>;
			compatible = "xlnx,psv-pmc-slave-boot-1.0" , "xlnx,ctrlregs";
			status = "okay";
			xlnx,ip-name = "psv_pmc_slave_boot";
			reg = <0x0 0xf1220000 0x0 0x10000>;
			firewall-0 = <&pmc_xppu>;
			xlnx,name = "versal_cips_0_pspmc_0_psv_pmc_slave_boot";
		};
		versal_cips_0_pspmc_0_psv_pmc_slave_boot_stream: psv_pmc_slave_boot_stream@f2100000 {
			xlnx,rable = <0>;
			xlnx,device-id = <0>;
			compatible = "xlnx,psv-pmc-slave-boot-stream-1.0";
			status = "okay";
			xlnx,ip-name = "psv_pmc_slave_boot_stream";
			reg = <0x0 0xf2100000 0x0 0x10000>;
			firewall-0 = <&pmc_xppu>;
			xlnx,name = "versal_cips_0_pspmc_0_psv_pmc_slave_boot_stream";
		};
		versal_cips_0_pspmc_0_psv_pmc_tmr_inject_0: tmr_inject@f0083000 {
			compatible = "xlnx,tmr-inject-1.0";
			xlnx,cpu-id = <1>;
			xlnx,edk-special = "tmr_inject";
			xlnx,highaddr = <0xF0284FFF>;
			xlnx,mask = <0x00000000 0x00084000>;
			xlnx,rable = <0>;
			xlnx,ip-name = "tmr_inject";
			reg = <0x0 0xf0083000 0x0 0x1000>;
			xlnx,magic = <0x27>;
			xlnx,edk-iptype = "PROCESSOR";
			xlnx,lmb-dwidth = <32>;
			status = "okay";
			xlnx,baseaddr = <0xF0284000>;
			xlnx,name = "versal_cips_0_pspmc_0_psv_pmc_tmr_inject_0";
			xlnx,lmb-awidth = <32>;
		};
		versal_cips_0_pspmc_0_psv_pmc_tmr_manager_0: tmr_manager@f0283000 {
			xlnx,use-debug-disable = <0>;
			xlnx,sem-interface-type = <1>;
			xlnx,magic1 = <0x00>;
			compatible = "xlnx,tmr-manager-1.0" , "xlnx,ctrlregs";
			xlnx,edk-special = "BRAM_CTRL";
			xlnx,tmr = <1>;
			xlnx,magic2 = <0x00>;
			xlnx,highaddr = <0xF0283FFF>;
			xlnx,brk-delay-rst-value = <0x00000000>;
			xlnx,mask = <0x00000000 0x00083000>;
			xlnx,sem-heartbeat-watchdog-width = <10>;
			xlnx,watchdog-width = <30>;
			xlnx,use-tmr-disable = <0>;
			xlnx,rable = <0>;
			xlnx,ue-width = <3>;
			xlnx,ip-name = "tmr_manager";
			xlnx,async-ff = <2>;
			xlnx,ue-is-fatal = <0>;
			xlnx,sem-heartbeat-watchdog = <0>;
			reg = <0x0 0xf0283000 0x0 0x1000>;
			xlnx,brk-delay-width = <0>;
			xlnx,watchdog = <0>;
			xlnx,sem-interface = <0>;
			xlnx,mask-rst-value = <0xffffffff 0xFFFFFFFF>;
			xlnx,lmb-dwidth = <32>;
			xlnx,comparators-mask = <0>;
			xlnx,edk-iptype = "PERIPHERAL";
			xlnx,test-comparator = <0>;
			xlnx,strict-miscompare = <0>;
			status = "okay";
			xlnx,baseaddr = <0xF0283000>;
			xlnx,no-of-comparators = <1>;
			xlnx,sem-async = <0>;
			xlnx,lmb-awidth = <32>;
			xlnx,name = "versal_cips_0_pspmc_0_psv_pmc_tmr_manager_0";
		};
		versal_cips_0_pspmc_0_psv_pmc_trng: psv_pmc_trng@f1230000 {
			xlnx,rable = <0>;
			xlnx,device-id = <0>;
			compatible = "xlnx,psv-pmc-trng-1.0" , "xlnx,ctrlregs";
			status = "okay";
			xlnx,ip-name = "psv_pmc_trng";
			reg = <0x0 0xf1230000 0x0 0x10000>;
			firewall-0 = <&pmc_xppu>;
			xlnx,name = "versal_cips_0_pspmc_0_psv_pmc_trng";
		};
		versal_cips_0_pspmc_0_psv_psm_global_reg: psv_psm_global_reg@ffc90000 {
			xlnx,rable = <0>;
			compatible = "xlnx,psv-psm-global-reg-1.0" , "xlnx,ctrlregs";
			status = "okay";
			xlnx,ip-name = "psv_psm_global_reg";
			reg = <0x0 0xffc90000 0x0 0xf000>;
			firewall-0 = <&lpd_xppu>;
			xlnx,name = "versal_cips_0_pspmc_0_psv_psm_global_reg";
		};
		versal_cips_0_pspmc_0_psv_psm_iomodule_0: iomodule@ffc80000 {
			xlnx,gpo4-size = <32>;
			xlnx,tmr = <0>;
			xlnx,pit1-readable = <1>;
			xlnx,mask = <0x00000000 0xFFFF8000>;
			xlnx,pit-size = < 32 32 32 32 >;
			firewall-0 = <&lpd_xppu>;
			xlnx,pit2-prescaler = <0>;
			xlnx,gpi3-interrupt = <0>;
			xlnx,intc-level-edge = <0x7fff>;
			xlnx,rable = <0>;
			xlnx,intc-positive = <0xFFFF>;
			xlnx,ip-name = "iomodule";
			xlnx,gpo1-size = <3>;
			xlnx,max-intr-size = <32>;
			xlnx,pit3-size = <32>;
			reg = <0x0 0xffc80000 0x0 0x8000>;
			xlnx,fit3-interrupt = <0>;
			xlnx,fit1-no-clocks = <6216>;
			xlnx,gpi2-size = <32>;
			xlnx,pit2-readable = <1>;
			xlnx,intc-irq-connection = <0>;
			xlnx,uart-tx-interrupt = <1>;
			xlnx,use-config-reset = <0>;
			xlnx,io-highaddr = <0x00000000 0x00000000>;
			xlnx,pit2-interrupt = <1>;
			xlnx,intc-base-vectors = <0xFFC00000>;
			xlnx,family = "kintex7";
			compatible = "xlnx,iomodule-1.0" , "xlnx,ctrlregs" , "xlnx,iomodule-3.1";
			xlnx,gpo4-init = <0x00000000>;
			xlnx,pit3-readable = <1>;
			xlnx,pit3-prescaler = <9>;
			xlnx,gpi4-interrupt = <0>;
			xlnx,gpo1-init = <0x00000000>;
			xlnx,use-io-bus = <0>;
			xlnx,use-gpo1 = <1>;
			xlnx,uart-baudrate = <115200>;
			xlnx,fit4-interrupt = <0>;
			xlnx,gpo3-size = <32>;
			xlnx,use-gpo2 = <0>;
			xlnx,uart-data-bits = <8>;
			xlnx,pit-prescaler = < 9 0 9 0 >;
			xlnx,use-gpo3 = <0>;
			xlnx,fit2-no-clocks = <6216>;
			xlnx,gpio1-board-interface = "Custom";
			xlnx,options = <1>;
			xlnx,use-gpo4 = <0>;
			xlnx,gpi4-size = <32>;
			xlnx,gpio2-board-interface = "Custom";
			xlnx,uart-rx-interrupt = <1>;
			xlnx,uart-error-interrupt = <1>;
			xlnx,gpio3-board-interface = "Custom";
			xlnx,pit4-readable = <1>;
			xlnx,intc-use-irq-out = <0>;
			xlnx,baseaddr = <0xFFC80000>;
			status = "okay";
			xlnx,gpio4-board-interface = "Custom";
			xlnx,clock-freq = <100000000>;
			xlnx,gpo-init = < 0 0 0 0 >;
			xlnx,use-board-flow;
			xlnx,pit2-size = <32>;
			xlnx,intc-use-ext-intr = <1>;
			xlnx,intc-intr-size = <16>;
			xlnx,name = "versal_cips_0_pspmc_0_psv_psm_iomodule_0";
			xlnx,gpi1-size = <32>;
			xlnx,pit3-interrupt = <1>;
			xlnx,edk-special = "INTR_CTRL";
			xlnx,intc-has-fast = <0>;
			xlnx,pit-used = < 1 1 1 1 >;
			xlnx,use-gpi1 = <0>;
			xlnx,gpi1-interrupt = <0>;
			xlnx,use-gpi2 = <0>;
			xlnx,use-gpi3 = <0>;
			xlnx,use-gpi4 = <0>;
			xlnx,fit1-interrupt = <0>;
			xlnx,pit4-prescaler = <0>;
			xlnx,gpo3-init = <0x00000000>;
			xlnx,intc-addr-width = <32>;
			xlnx,edk-iptype = "PERIPHERAL";
			xlnx,fit3-no-clocks = <6216>;
			xlnx,use-uart-rx = <1>;
			xlnx,instance = "iomodule_0";
			xlnx,pit-mask = <0xFFFFFFFF 0xFFFFFFFF 0xFFFFFFFF 0xFFFFFFFF>;
			xlnx,uart-prog-baudrate = <1>;
			xlnx,use-pit1 = <1>;
			xlnx,gpo2-size = <32>;
			xlnx,use-pit2 = <1>;
			xlnx,pit4-size = <32>;
			xlnx,pit-readable = < 1 1 1 1 >;
			xlnx,use-pit3 = <1>;
			xlnx,use-pit4 = <1>;
			xlnx,pit4-interrupt = <1>;
			xlnx,gpi3-size = <32>;
			xlnx,highaddr = <0xFFC87FFF>;
			xlnx,intc-async-intr = <0xFFFF>;
			xlnx,pit1-prescaler = <9>;
			xlnx,avoid-primitives = <0>;
			xlnx,gpi2-interrupt = <0>;
			xlnx,use-tmr-disable = <0>;
			xlnx,use-fit1 = <0>;
			xlnx,pit1-size = <32>;
			xlnx,intc-num-sync-ff = <2>;
			xlnx,use-fit2 = <0>;
			xlnx,uart-board-interface = "rs232_uart";
			xlnx,fit2-interrupt = <0>;
			xlnx,use-fit3 = <0>;
			xlnx,use-fit4 = <0>;
			xlnx,io-baseaddr = <0xffffffff 0xFFFFFFFF>;
			xlnx,uart-use-parity = <0>;
			xlnx,lmb-dwidth = <32>;
			xlnx,fit4-no-clocks = <6216>;
			xlnx,uart-odd-parity = <0>;
			xlnx,freq = <100000000>;
			xlnx,use-uart-tx = <1>;
			xlnx,pit1-interrupt = <1>;
			xlnx,lmb-awidth = <32>;
			xlnx,io-mask = <0x00000000 0xFFFE0000>;
			xlnx,gpo2-init = <0x00000000>;
		};
		versal_cips_0_pspmc_0_psv_psm_ram_data_cntlr: PSM_PPU@ffc20000 {
			xlnx,write-access = <2>;
			xlnx,family = "kintex7";
			xlnx,edk-special = "BRAM_CTRL";
			compatible = "xlnx,PSM-PPU-1.0";
			xlnx,ecc-onoff-register = <1>;
			xlnx,ecc-onoff-reset-value = <1>;
			xlnx,s-axi-ctrl-protocol = "AXI4LITE";
			xlnx,highaddr = <0xFFC3FFFF>;
			xlnx,s-axi-ctrl-highaddr = <0xFFCBFFFF>;
			xlnx,mask = <0xffffffff 0xFFFFE000>;
			firewall-0 = <&lpd_xppu>;
			xlnx,mask1 = <0xffffffff 0xFFFFE000>;
			xlnx,s-axi-ctrl-aclk-freq-hz = <100000000>;
			xlnx,rable = <0>;
			xlnx,mask2 = <0x00000000 0x00800000>;
			xlnx,fault-inject = <1>;
			xlnx,mask3 = <0x00000000 0x00800000>;
			xlnx,ip-name = "PSM_PPU";
			xlnx,num-lmb = <2>;
			reg = <0x0 0xffc20000 0x0 0x20000>;
			xlnx,s-axi-ctrl-addr-width = <32>;
			xlnx,ecc-status-registers = <1>;
			xlnx,ce-counter-width = <16>;
			xlnx,ecc = <1>;
			xlnx,lmb-dwidth = <32>;
			xlnx,interconnect = <2>;
			xlnx,edk-iptype = "PERIPHERAL";
			xlnx,ce-failing-registers = <1>;
			xlnx,ue-failing-registers = <1>;
			status = "okay";
			xlnx,baseaddr = <0xFFC20000>;
			xlnx,s-axi-ctrl-baseaddr = <0xFFCB0000>;
			xlnx,s-axi-ctrl-data-width = <32>;
			xlnx,bram-awidth = <32>;
			xlnx,lmb-awidth = <32>;
			xlnx,name = "versal_cips_0_pspmc_0_psv_psm_ram_data_cntlr";
		};
		versal_cips_0_pspmc_0_psv_psm_ram_instr_cntlr: ram_instr_cntlr@ffc00000 {
			xlnx,write-access = <2>;
			xlnx,family = "kintex7";
			xlnx,edk-special = "BRAM_CTRL";
			compatible = "xlnx,ram-instr-cntlr-1.0";
			xlnx,ecc-onoff-register = <1>;
			xlnx,ecc-onoff-reset-value = <1>;
			xlnx,s-axi-ctrl-protocol = "AXI4LITE";
			xlnx,highaddr = <0xFFC1FFFF>;
			xlnx,s-axi-ctrl-highaddr = <0xFFCAFFFF>;
			xlnx,mask = <0xffffffff 0xFFFE0000>;
			firewall-0 = <&lpd_xppu>;
			xlnx,mask1 = <0xffffffff 0xFFFE0000>;
			xlnx,s-axi-ctrl-aclk-freq-hz = <100000000>;
			xlnx,rable = <0>;
			xlnx,mask2 = <0x00000000 0x00800000>;
			xlnx,fault-inject = <1>;
			xlnx,mask3 = <0x00000000 0x00800000>;
			xlnx,ip-name = "ram_instr_cntlr";
			xlnx,num-lmb = <2>;
			reg = <0x0 0xffc00000 0x0 0x20000>;
			xlnx,s-axi-ctrl-addr-width = <32>;
			xlnx,ecc-status-registers = <1>;
			xlnx,ce-counter-width = <16>;
			xlnx,ecc = <1>;
			xlnx,lmb-dwidth = <32>;
			xlnx,interconnect = <2>;
			xlnx,edk-iptype = "PERIPHERAL";
			xlnx,ce-failing-registers = <1>;
			xlnx,ue-failing-registers = <1>;
			status = "okay";
			xlnx,baseaddr = <0xFFC00000>;
			xlnx,s-axi-ctrl-baseaddr = <0xFFCA0000>;
			xlnx,s-axi-ctrl-data-width = <32>;
			xlnx,bram-awidth = <32>;
			xlnx,lmb-awidth = <32>;
			xlnx,name = "versal_cips_0_pspmc_0_psv_psm_ram_instr_cntlr";
		};
		versal_cips_0_pspmc_0_psv_psm_tmr_inject_0: tmr_inject@ffcd0000 {
			compatible = "xlnx,tmr-inject-1.0" , "xlnx,ctrlregs";
			xlnx,cpu-id = <1>;
			xlnx,edk-special = "tmr_inject";
			xlnx,highaddr = <0xFFCDFFFF>;
			xlnx,mask = <0x00000000 0x00050000>;
			firewall-0 = <&lpd_xppu>;
			xlnx,rable = <0>;
			xlnx,ip-name = "tmr_inject";
			reg = <0x0 0xffcd0000 0x0 0x10000>;
			xlnx,magic = <0x27>;
			xlnx,edk-iptype = "PROCESSOR";
			xlnx,lmb-dwidth = <32>;
			status = "okay";
			xlnx,baseaddr = <0xFFCD0000>;
			xlnx,name = "versal_cips_0_pspmc_0_psv_psm_tmr_inject_0";
			xlnx,lmb-awidth = <32>;
		};
		versal_cips_0_pspmc_0_psv_psm_tmr_manager_0: tmr_manager@ffcc0000 {
			xlnx,use-debug-disable = <0>;
			xlnx,sem-interface-type = <1>;
			xlnx,magic1 = <0x00>;
			compatible = "xlnx,tmr-manager-1.0" , "xlnx,ctrlregs";
			xlnx,edk-special = "BRAM_CTRL";
			xlnx,tmr = <1>;
			xlnx,magic2 = <0x00>;
			xlnx,highaddr = <0xFFCCFFFF>;
			xlnx,brk-delay-rst-value = <0x00000000>;
			xlnx,mask = <0x00000000 0x00050000>;
			firewall-0 = <&lpd_xppu>;
			xlnx,sem-heartbeat-watchdog-width = <10>;
			xlnx,watchdog-width = <30>;
			xlnx,use-tmr-disable = <0>;
			xlnx,rable = <0>;
			xlnx,ue-width = <3>;
			xlnx,ip-name = "tmr_manager";
			xlnx,async-ff = <2>;
			xlnx,ue-is-fatal = <0>;
			xlnx,sem-heartbeat-watchdog = <0>;
			reg = <0x0 0xffcc0000 0x0 0x10000>;
			xlnx,brk-delay-width = <0>;
			xlnx,watchdog = <0>;
			xlnx,sem-interface = <0>;
			xlnx,mask-rst-value = <0xffffffff 0xFFFFFFFF>;
			xlnx,lmb-dwidth = <32>;
			xlnx,comparators-mask = <0>;
			xlnx,edk-iptype = "PERIPHERAL";
			xlnx,test-comparator = <0>;
			xlnx,strict-miscompare = <0>;
			status = "okay";
			xlnx,baseaddr = <0xFFCC0000>;
			xlnx,no-of-comparators = <1>;
			xlnx,sem-async = <0>;
			xlnx,lmb-awidth = <32>;
			xlnx,name = "versal_cips_0_pspmc_0_psv_psm_tmr_manager_0";
		};
		versal_cips_0_pspmc_0_psv_r5_0_atcm: psv_r5_tcm@0000 {
			xlnx,rable = <0>;
			compatible = "xlnx,psv-r5-tcm-1.0";
			status = "okay";
			xlnx,ip-name = "psv_r5_tcm";
			reg = <0x0 0x0000 0x0 0x10000>;
			xlnx,name = "versal_cips_0_pspmc_0_psv_r5_0_atcm";
		};
		versal_cips_0_pspmc_0_psv_r5_0_atcm_global: psv_tcm_global@ffe00000 {
			xlnx,rable = <0>;
			compatible = "xlnx,psv-tcm-global-1.0" , "mmio-sram";
			status = "okay";
			power-domains = <&versal_firmware 0x1831800b>;
			xlnx,ip-name = "psv_tcm_global";
			reg = <0x0 0xffe00000 0x0 0x10000>;
			firewall-0 = <&lpd_xppu>;
			xlnx,name = "versal_cips_0_pspmc_0_psv_r5_0_atcm_global";
		};
		versal_cips_0_pspmc_0_psv_r5_0_atcm_lockstep: psv_r5_0_atcm_lockstep@ffe10000 {
			xlnx,rable = <0>;
			compatible = "xlnx,psv-r5-0-atcm-lockstep-1.0" , "mmio-sram";
			status = "okay";
			power-domains = <&versal_firmware 0x1831800b>;
			xlnx,ip-name = "psv_r5_0_atcm_lockstep";
			reg = <0x0 0xffe10000 0x0 0x10000>;
			firewall-0 = <&lpd_xppu>;
			xlnx,name = "versal_cips_0_pspmc_0_psv_r5_0_atcm_lockstep";
		};
		versal_cips_0_pspmc_0_psv_r5_0_btcm: psv_r5_tcm@20000 {
			xlnx,rable = <0>;
			compatible = "xlnx,psv-r5-tcm-1.0";
			status = "okay";
			xlnx,ip-name = "psv_r5_tcm";
			reg = <0x0 0x20000 0x0 0x10000>;
			xlnx,name = "versal_cips_0_pspmc_0_psv_r5_0_btcm";
		};
		versal_cips_0_pspmc_0_psv_r5_0_btcm_global: psv_tcm_global@ffe20000 {
			xlnx,rable = <0>;
			compatible = "xlnx,psv-tcm-global-1.0" , "mmio-sram";
			status = "okay";
			power-domains = <&versal_firmware 0x1831800c>;
			xlnx,ip-name = "psv_tcm_global";
			reg = <0x0 0xffe20000 0x0 0x10000>;
			firewall-0 = <&lpd_xppu>;
			xlnx,name = "versal_cips_0_pspmc_0_psv_r5_0_btcm_global";
		};
		versal_cips_0_pspmc_0_psv_r5_0_btcm_lockstep: psv_r5_0_btcm_lockstep@ffe30000 {
			xlnx,rable = <0>;
			compatible = "xlnx,psv-r5-0-btcm-lockstep-1.0" , "mmio-sram";
			status = "okay";
			power-domains = <&versal_firmware 0x1831800c>;
			xlnx,ip-name = "psv_r5_0_btcm_lockstep";
			reg = <0x0 0xffe30000 0x0 0x10000>;
			firewall-0 = <&lpd_xppu>;
			xlnx,name = "versal_cips_0_pspmc_0_psv_r5_0_btcm_lockstep";
		};
		versal_cips_0_pspmc_0_psv_r5_0_data_cache: psv_r5_0_data_cache@ffe50000 {
			xlnx,rable = <0>;
			compatible = "xlnx,psv-r5-0-data-cache-1.0";
			status = "okay";
			xlnx,ip-name = "psv_r5_0_data_cache";
			reg = <0x0 0xffe50000 0x0 0x10000>;
			firewall-0 = <&lpd_xppu>;
			xlnx,name = "versal_cips_0_pspmc_0_psv_r5_0_data_cache";
		};
		versal_cips_0_pspmc_0_psv_r5_0_instruction_cache: psv_r5_0_instruction_cache@ffe40000 {
			xlnx,rable = <0>;
			compatible = "xlnx,psv-r5-0-instruction-cache-1.0";
			status = "okay";
			xlnx,ip-name = "psv_r5_0_instruction_cache";
			reg = <0x0 0xffe40000 0x0 0x10000>;
			firewall-0 = <&lpd_xppu>;
			xlnx,name = "versal_cips_0_pspmc_0_psv_r5_0_instruction_cache";
		};
		versal_cips_0_pspmc_0_psv_r5_1_atcm: psv_r5_tcm@0000 {
			xlnx,rable = <0>;
			compatible = "xlnx,psv-r5-tcm-1.0";
			status = "okay";
			xlnx,ip-name = "psv_r5_tcm";
			reg = <0x0 0x0000 0x0 0x10000>;
			xlnx,name = "versal_cips_0_pspmc_0_psv_r5_1_atcm";
		};
		versal_cips_0_pspmc_0_psv_r5_1_atcm_global: psv_tcm_global@ffe90000 {
			xlnx,rable = <0>;
			compatible = "xlnx,psv-tcm-global-1.0" , "mmio-sram";
			status = "okay";
			power-domains = <&versal_firmware 0x1831800d>;
			xlnx,ip-name = "psv_tcm_global";
			reg = <0x0 0xffe90000 0x0 0x10000>;
			firewall-0 = <&lpd_xppu>;
			xlnx,name = "versal_cips_0_pspmc_0_psv_r5_1_atcm_global";
		};
		versal_cips_0_pspmc_0_psv_r5_1_btcm: psv_r5_tcm@20000 {
			xlnx,rable = <0>;
			compatible = "xlnx,psv-r5-tcm-1.0";
			status = "okay";
			xlnx,ip-name = "psv_r5_tcm";
			reg = <0x0 0x20000 0x0 0x10000>;
			xlnx,name = "versal_cips_0_pspmc_0_psv_r5_1_btcm";
		};
		versal_cips_0_pspmc_0_psv_r5_1_btcm_global: psv_tcm_global@ffeb0000 {
			xlnx,rable = <0>;
			compatible = "xlnx,psv-tcm-global-1.0" , "mmio-sram";
			status = "okay";
			power-domains = <&versal_firmware 0x1831800e>;
			xlnx,ip-name = "psv_tcm_global";
			reg = <0x0 0xffeb0000 0x0 0x10000>;
			firewall-0 = <&lpd_xppu>;
			xlnx,name = "versal_cips_0_pspmc_0_psv_r5_1_btcm_global";
		};
		versal_cips_0_pspmc_0_psv_r5_1_data_cache: psv_r5_1_data_cache@ffed0000 {
			xlnx,rable = <0>;
			compatible = "xlnx,psv-r5-1-data-cache-1.0";
			status = "okay";
			xlnx,ip-name = "psv_r5_1_data_cache";
			reg = <0x0 0xffed0000 0x0 0x10000>;
			firewall-0 = <&lpd_xppu>;
			xlnx,name = "versal_cips_0_pspmc_0_psv_r5_1_data_cache";
		};
		versal_cips_0_pspmc_0_psv_r5_1_instruction_cache: psv_r5_1_instruction_cache@ffec0000 {
			xlnx,rable = <0>;
			compatible = "xlnx,psv-r5-1-instruction-cache-1.0";
			status = "okay";
			xlnx,ip-name = "psv_r5_1_instruction_cache";
			reg = <0x0 0xffec0000 0x0 0x10000>;
			firewall-0 = <&lpd_xppu>;
			xlnx,name = "versal_cips_0_pspmc_0_psv_r5_1_instruction_cache";
		};
		versal_cips_0_pspmc_0_psv_r5_tcm_ram_0: psv_r5_tcm@00000 {
			xlnx,rable = <0>;
			compatible = "xlnx,psv-r5-tcm-1.0";
			status = "okay";
			xlnx,ip-name = "psv_r5_tcm";
			reg = <0x0 0x00000 0x0 0x40000>;
			xlnx,name = "versal_cips_0_pspmc_0_psv_r5_tcm_ram_0";
		};
		versal_cips_0_pspmc_0_psv_r5_tcm_ram_global: psv_r5_tcm@ffe00000 {
			xlnx,rable = <0>;
			compatible = "xlnx,psv-r5-tcm-1.0" , "mmio-sram";
			status = "okay";
			power-domains = <&versal_firmware 0x1831800b>;
			xlnx,ip-name = "psv_r5_tcm";
			reg = <0x0 0xffe00000 0x0 0x40000>;
			firewall-0 = <&lpd_xppu>;
			xlnx,name = "versal_cips_0_pspmc_0_psv_r5_tcm_ram_global";
		};
		versal_cips_0_pspmc_0_psv_rpu_0: psv_rpu@ff9a0000 {
			xlnx,rable = <0>;
			compatible = "xlnx,psv-rpu-1.0";
			status = "okay";
			xlnx,ip-name = "psv_rpu";
			reg = <0x0 0xff9a0000 0x0 0x10000>;
			firewall-0 = <&lpd_xppu>;
			xlnx,name = "versal_cips_0_pspmc_0_psv_rpu_0";
		};
		versal_cips_0_pspmc_0_psv_scntr_0: psv_scntr@ff130000 {
			xlnx,rable = <0>;
			compatible = "xlnx,psv-scntr-1.0" , "xlnx,ctrlregs";
			status = "okay";
			xlnx,ip-name = "psv_scntr";
			reg = <0x0 0xff130000 0x0 0x10000>;
			firewall-0 = <&lpd_xppu>;
			xlnx,name = "versal_cips_0_pspmc_0_psv_scntr_0";
		};
		versal_cips_0_pspmc_0_psv_scntrs_0: psv_scntrs@ff140000 {
			xlnx,rable = <0>;
			compatible = "xlnx,psv-scntrs-1.0" , "xlnx,ctrlregs";
			status = "okay";
			xlnx,ip-name = "psv_scntrs";
			reg = <0x0 0xff140000 0x0 0x10000>;
			firewall-0 = <&lpd_xppu>;
			xlnx,name = "versal_cips_0_pspmc_0_psv_scntrs_0";
		};
	};
	&psv_psm_0 {
		xlnx,addr-tag-bits = <0>;
		xlnx,d-axi = <1>;
		xlnx,m-axi-dc-thread-id-width = <1>;
		xlnx,m0-axis-protocol = "GENERIC";
		xlnx,dcache-force-tag-lutram = <0>;
		xlnx,interrupt-is-edge = <0>;
		xlnx,use-mmu = <0>;
		xlnx,m-axi-dp-exclusive-access = <0>;
		xlnx,use-reorder-instr = <1>;
		xlnx,m14-axis-protocol = "GENERIC";
		xlnx,use-div = <1>;
		xlnx,dc-axi-mon = <0>;
		xlnx,m-axi-ic-user-signals = <0>;
		xlnx,use-config-reset = <0>;
		xlnx,s14-axis-protocol = "GENERIC";
		xlnx,family = "kintex7";
		xlnx,mmu-zones = <16>;
		xlnx,enable-discrete-ports = <0>;
		xlnx,d-lmb = <1>;
		xlnx,m-axi-dc-exclusive-access = <0>;
		xlnx,sco = <0>;
		xlnx,s9-axis-protocol = "GENERIC";
		xlnx,debug-interface = <0>;
		xlnx,use-ext-brk = <0>;
		xlnx,debug-enabled = <1>;
		xlnx,daddr-size = <32>;
		xlnx,s0-axis-data-width = <32>;
		xlnx,use-extended-fsl-instr = <0>;
		xlnx,m-axi-dc-user-signals = <0>;
		xlnx,reset-msr = <0x00000000>;
		xlnx,branch-target-cache-size = <0>;
		xlnx,s2-axis-data-width = <32>;
		bus-handle = <&amba>;
		xlnx,cache-byte-size = <8192>;
		xlnx,mmu-tlb-access = <3>;
		xlnx,s4-axis-data-width = <32>;
		xlnx,m-axi-ic-awuser-width = <5>;
		xlnx,s6-axis-data-width = <32>;
		xlnx,s4-axis-protocol = "GENERIC";
		xlnx,s8-axis-data-width = <32>;
		xlnx,use-dcache = <0>;
		xlnx,edk-special = "microblaze";
		xlnx,m-axi-dp-addr-width = <32>;
		xlnx,m-axi-ic-wuser-width = <1>;
		xlnx,i-axi = <0>;
		xlnx,icache-streams = <0>;
		xlnx,m-axi-dc-awuser-width = <5>;
		xlnx,pss-ref-clk-freq = <33333300>;
		xlnx,use-stack-protection = <1>;
		xlnx,m6-axis-protocol = "GENERIC";
		xlnx,num-sync-ff-dbg-clk = <1>;
		xlnx,m-axi-ip-data-width = <32>;
		d-cache-size = <8192>;
		xlnx,use-pcmp-instr = <1>;
		xlnx,icache-baseaddr = <0x00000000 0x00000000>;
		xlnx,area-optimized = <0>;
		xlnx,avoid-primitives = <0>;
		xlnx,m1-axis-protocol = "GENERIC";
		xlnx,i-lmb = <1>;
		xlnx,lockstep-select = <0>;
		xlnx,dcache-baseaddr = <0x00000000 0x00000000>;
		xlnx,dcache-data-width = <0>;
		xlnx,icache-force-tag-lutram = <0>;
		xlnx,m15-axis-protocol = "GENERIC";
		xlnx,use-branch-target-cache = <0>;
		xlnx,m-axi-ip-thread-id-width = <1>;
		xlnx,mmu-itlb-size = <2>;
		xlnx,number-of-pc-brk = <2>;
		xlnx,imprecise-exceptions = <0>;
		xlnx,m-axi-ic-buser-width = <1>;
		xlnx,m-axi-ic-addr-width = <32>;
		xlnx,s15-axis-protocol = "GENERIC";
		d-cache-highaddr = <0x000000003FFFFFFF>;
		xlnx,m10-axis-protocol = "GENERIC";
		xlnx,optimization = <0>;
		xlnx,m-axi-ic-aruser-width = <5>;
		xlnx,d-lmb-mon = <0>;
		xlnx,s10-axis-protocol = "GENERIC";
		xlnx,m-axi-ic-ruser-width = <1>;
		xlnx,s5-axis-protocol = "GENERIC";
		xlnx,fault-tolerant = <1>;
		d-cache-line-size = <16>;
		xlnx,m-axi-dc-aruser-width = <5>;
		xlnx,mmu-privileged-instr = <0>;
		xlnx,m-axi-i-bus-exception = <0>;
		xlnx,reset-msr-eip = <0>;
		xlnx,endianness = <1>;
		xlnx,reset-msr-ice = <0>;
		xlnx,dp-axi-mon = <0>;
		xlnx,s10-axis-data-width = <32>;
		xlnx,s0-axis-protocol = "GENERIC";
		xlnx,s12-axis-data-width = <32>;
		xlnx,m7-axis-protocol = "GENERIC";
		xlnx,s14-axis-data-width = <32>;
		xlnx,m-axi-d-bus-exception = <1>;
		xlnx,reset-msr-bip = <1>;
		xlnx,debug-external-trace = <0>;
		xlnx,addr-size = <32>;
		xlnx,m-axi-ic-user-value = <31>;
		xlnx,m1-axis-data-width = <32>;
		xlnx,debug-event-counters = <5>;
		xlnx,m3-axis-data-width = <32>;
		xlnx,fpu-exception = <0>;
		xlnx,m2-axis-protocol = "GENERIC";
		xlnx,m5-axis-data-width = <32>;
		xlnx,m7-axis-data-width = <32>;
		xlnx,edk-iptype = "PROCESSOR";
		xlnx,debug-latency-counters = <1>;
		xlnx,interconnect = <2>;
		xlnx,m9-axis-data-width = <32>;
		xlnx,edge-is-positive = <1>;
		xlnx,use-icache = <0>;
		xlnx,async-wakeup = <3>;
		xlnx,m10-axis-data-width = <32>;
		xlnx,m12-axis-data-width = <32>;
		xlnx,use-ext-nm-brk = <0>;
		xlnx,m11-axis-protocol = "GENERIC";
		xlnx,m14-axis-data-width = <32>;
		xlnx,icache-always-used = <0>;
		xlnx,ic-axi-mon = <0>;
		xlnx,num-sync-ff-clk-irq = <1>;
		xlnx,freq = <100000000>;
		xlnx,lockstep-master = <0>;
		xlnx,s11-axis-protocol = "GENERIC";
		xlnx,use-msr-instr = <1>;
		xlnx,s6-axis-protocol = "GENERIC";
		xlnx,iaddr-size = <32>;
		xlnx,interrupt-mon = <0>;
		xlnx,m-axi-dc-data-width = <32>;
		xlnx,dynamic-bus-sizing = <0>;
		xlnx,icache-highaddr = <0x00000000 0x3FFFFFFF>;
		xlnx,number-of-wr-addr-brk = <1>;
		xlnx,use-interrupt = <1>;
		xlnx,m-axi-ip-addr-width = <32>;
		xlnx,async-interrupt = <1>;
		xlnx,pc-width = <32>;
		xlnx,icache-victims = <0>;
		xlnx,reset-msr-ee = <0>;
		xlnx,s1-axis-protocol = "GENERIC";
		xlnx,m8-axis-protocol = "GENERIC";
		i-cache-baseaddr = <0x0000000000000000>;
		xlnx,dcache-highaddr = <0x00000000 0x3FFFFFFF>;
		xlnx,i-lmb-mon = <0>;
		xlnx,dcache-byte-size = <8192>;
		xlnx,m-axi-dp-thread-id-width = <1>;
		xlnx,data-size = <32>;
		xlnx,m-axi-dc-wuser-width = <1>;
		xlnx,fsl-exception = <0>;
		xlnx,m3-axis-protocol = "GENERIC";
		xlnx,s1-axis-data-width = <32>;
		xlnx,dcache-use-writeback = <0>;
		xlnx,div-zero-exception = <1>;
		xlnx,s3-axis-data-width = <32>;
		xlnx,base-vectors = <0x00000000 0xFFC00000>;
		xlnx,icache-line-len = <4>;
		xlnx,s5-axis-data-width = <32>;
		xlnx,s7-axis-data-width = <32>;
		xlnx,use-barrel = <1>;
		xlnx,s9-axis-data-width = <32>;
		xlnx,allow-dcache-wr = <1>;
		xlnx,g-use-exceptions = <1>;
		xlnx,dcache-line-len = <4>;
		xlnx,m12-axis-protocol = "GENERIC";
		xlnx,num-sync-ff-clk = <2>;
		i-cache-size = <8192>;
		xlnx,instance = "design_1_microblaze_0_0";
		xlnx,reset-msr-ie = <0>;
		xlnx,s12-axis-protocol = "GENERIC";
		xlnx,dcache-addr-tag = <0>;
		xlnx,m-axi-ic-thread-id-width = <1>;
		xlnx,number-of-rd-addr-brk = <1>;
		xlnx,m-axi-dc-buser-width = <1>;
		xlnx,s7-axis-protocol = "GENERIC";
		xlnx,lockstep-slave = <0>;
		xlnx,debug-profile-size = <0>;
		xlnx,s2-axis-protocol = "GENERIC";
		xlnx,m9-axis-protocol = "GENERIC";
		xlnx,debug-counter-width = <32>;
		xlnx,icache-data-width = <0>;
		xlnx,m-axi-dc-ruser-width = <1>;
		xlnx,reset-msr-dce = <0>;
		xlnx,rable = <0>;
		xlnx,ip-name = "psv_psm";
		xlnx,ip-axi-mon = <0>;
		xlnx,m-axi-dp-data-width = <32>;
		xlnx,m4-axis-protocol = "GENERIC";
		xlnx,dcache-always-used = <0>;
		xlnx,ill-opcode-exception = <1>;
		xlnx,trace = <1>;
		xlnx,pvr = <2>;
		xlnx,debug-trace-size = <8192>;
		i-cache-line-size = <16>;
		xlnx,m13-axis-protocol = "GENERIC";
		xlnx,s11-axis-data-width = <32>;
		xlnx,m-axi-dc-addr-width = <32>;
		xlnx,s13-axis-data-width = <32>;
		xlnx,ecc-use-ce-exception = <0>;
		xlnx,opcode-0x0-illegal = <1>;
		xlnx,pvr-user2 = <0x00000000>;
		xlnx,s15-axis-data-width = <32>;
		xlnx,s13-axis-protocol = "GENERIC";
		xlnx,m0-axis-data-width = <32>;
		i-cache-highaddr = <0x000000003FFFFFFF>;
		xlnx,s8-axis-protocol = "GENERIC";
		xlnx,m2-axis-data-width = <32>;
		xlnx,num-sync-ff-clk-debug = <2>;
		xlnx,allow-icache-wr = <1>;
		xlnx,m4-axis-data-width = <32>;
		xlnx,g-template-list = <0>;
		xlnx,m6-axis-data-width = <32>;
		xlnx,m-axi-ic-data-width = <32>;
		xlnx,m8-axis-data-width = <32>;
		xlnx,use-hw-mul = <2>;
		xlnx,use-fpu = <0>;
		xlnx,s3-axis-protocol = "GENERIC";
		xlnx,use-non-secure = <0>;
		d-cache-baseaddr = <0x0000000000000000>;
		xlnx,m11-axis-data-width = <32>;
		xlnx,m13-axis-data-width = <32>;
		xlnx,instr-size = <32>;
		xlnx,m15-axis-data-width = <32>;
		xlnx,mmu-dtlb-size = <4>;
		xlnx,fsl-links = <0>;
		xlnx,m5-axis-protocol = "GENERIC";
		xlnx,dcache-victims = <0>;
		xlnx,unaligned-exceptions = <1>;
		xlnx,m-axi-dc-user-value = <31>;
	};
	&psv_cortexr5_0 {
		xlnx,rable = <0>;
		xlnx,pss-ref-clk-freq = <33333300>;
		xlnx,is-cache-coherent = <0>;
		xlnx,ip-name = "psv_cortexr5";
		access-val = <0xff>;
		bus-handle = <&amba>;
		cpu-frequency = <591666077>;
		xlnx,cpu-clk-freq-hz = <591666077>;
	};
	&psv_cortexr5_1 {
		xlnx,rable = <0>;
		xlnx,pss-ref-clk-freq = <33333300>;
		xlnx,is-cache-coherent = <0>;
		xlnx,ip-name = "psv_cortexr5";
		access-val = <0xff>;
		bus-handle = <&amba>;
		cpu-frequency = <591666077>;
		xlnx,cpu-clk-freq-hz = <591666077>;
	};
